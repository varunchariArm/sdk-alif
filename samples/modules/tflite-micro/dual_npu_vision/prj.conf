## CMakeLists.txt
```
cmake_minimum_required(VERSION 3.20)

set(CMAKE_SKIP_INSTALL_RULES ON CACHE BOOL "" FORCE)
set(ETHOSU_MULTI_VARIANT ON CACHE BOOL "" FORCE)
set(CMSIS_PATH "$ENV{ZEPHYR_BASE}/../modules/hal/cmsis"
    CACHE PATH "" FORCE)

find_package(Zephyr REQUIRED HINTS $ENV{ZEPHYR_BASE})
project(tflm_dual_npu C CXX)

set(MODEL_DIR "${CMAKE_CURRENT_LIST_DIR}/models")
set(U85_MODEL "${MODEL_DIR}/mobilenet_v2_imagenet_u85_256.tflite")
set(U55_MODEL "${MODEL_DIR}/comparable_ssd_slim_u55_256.tflite")
set(FACE_BMP "${MODEL_DIR}/grace_hopper.bmp")
set(CLASS_LABELS "${MODEL_DIR}/labels_imagenet_1000.txt")
set(SRAM0_PAYLOAD "${CMAKE_CURRENT_BINARY_DIR}/u85_model.bin")

# Model sizes define the packed payload offsets compiled into model_layout.h.
# Re-run CMake whenever an artifact is replaced so an incremental build cannot
# combine a new payload with stale firmware addresses.
set_property(DIRECTORY APPEND PROPERTY CMAKE_CONFIGURE_DEPENDS
  "${U85_MODEL}" "${U55_MODEL}" "${FACE_BMP}" "${CLASS_LABELS}")

file(SIZE "${U85_MODEL}" U85_MODEL_SIZE)
file(SIZE "${U55_MODEL}" U55_MODEL_SIZE)
file(SIZE "${FACE_BMP}" FACE_BMP_SIZE)
file(SIZE "${CLASS_LABELS}" CLASS_LABELS_SIZE)
configure_file(src/model_layout.h.in
               "${CMAKE_CURRENT_BINARY_DIR}/model_layout.h" @ONLY)

add_custom_command(
  OUTPUT "${SRAM0_PAYLOAD}"
  COMMAND "${Python3_EXECUTABLE}"
          "${CMAKE_CURRENT_LIST_DIR}/tools/pack_sram0_payload.py"
          --output "${SRAM0_PAYLOAD}" "${U85_MODEL}" "${U55_MODEL}" "${FACE_BMP}"
          "${CLASS_LABELS}"
  DEPENDS "${U85_MODEL}" "${U55_MODEL}" "${FACE_BMP}" "${CLASS_LABELS}"
          "${CMAKE_CURRENT_LIST_DIR}/tools/pack_sram0_payload.py"
  VERBATIM)
add_custom_target(gen_sram0_payload ALL DEPENDS "${SRAM0_PAYLOAD}")
add_dependencies(app gen_sram0_payload)

target_sources(app PRIVATE
  src/main.cpp
  src/board_init.c
  src/zephyr_vision.c
  src/ethosu_platform.c)
target_include_directories(app PRIVATE src "${CMAKE_CURRENT_BINARY_DIR}")

if(TARGET ethosu_core_driver)
  target_link_libraries(app PRIVATE ethosu_core_driver)
  target_compile_definitions(ethosu_core_driver PRIVATE
    ETHOSU_SEMAPHORE_WAIT_INFERENCE=10000
    NPU_MEM_ATTR_0=0x20
    NPU_MEM_ATTR_1=0x20
    NPU_MEM_ATTR_2=0x24
    NPU_MEM_ATTR_3=0x24
    AXI_LIMIT_SRAM_MAX_BEATS=2
    AXI_LIMIT_EXT_MAX_BEATS=2
    AXI_LIMIT_EXT_MAX_OUTSTANDING_READ=1
    AXI_LIMIT_EXT_MAX_OUTSTANDING_WRITE=1)
endif()

# The Alif callback implements the legacy single-device ABI. This application
# supplies the platform hooks and both NPU instances to the multi-variant
# upstream Ethos-U core driver.
set(alif_ethosu_target "..__modules__hal__alif__drivers__ethos_u")
if(TARGET "${alif_ethosu_target}")
  get_target_property(alif_sources "${alif_ethosu_target}" SOURCES)
  list(FILTER alif_sources EXCLUDE REGEX "/ethosu_callback\\.c$")
  if(NOT alif_sources)
    set(alif_sources "${CMAKE_CURRENT_LIST_DIR}/src/ethosu_alif_abi_stub.c")
  endif()
  set_property(TARGET "${alif_ethosu_target}" PROPERTY SOURCES "${alif_sources}")
endif()
```

## Kconfig
```
source "Kconfig.zephyr"

menu "Dual-NPU application"

config DUAL_TFLM_LIVE_VISION
	bool "Use J16 MT9M114 camera and MW405-C display"
	default n
	help
	  Replace the preloaded BMP with a zero-copy RGB565 camera/display
	  framebuffer. The J16 selfie camera uses RX D-PHY 0 while the display
	  uses TX D-PHY 1.

endmenu
```

## sample.yaml
```
sample:
  name: TFLite Micro dual-NPU live vision
  description: Parallel U55 SSD face detection and U85 MobileNetV2 classification
common:
  tags:
    - samples
    - tflite-micro
    - video
  platform_allow:
    - alif_e8_dk/ae822fa0e5597xx0/rtss_hp
  build_only: true
tests:
  sample.modules.tflite_micro.dual_npu_vision: {}
```

## prj.conf
```kconfig
CONFIG_TENSORFLOW_LITE_MICRO=y
CONFIG_CPP=y
CONFIG_STD_CPP17=y
CONFIG_MAIN_STACK_SIZE=16384
CONFIG_HEAP_MEM_POOL_SIZE=65536
CONFIG_SYS_HEAP_AUTO=y
CONFIG_CONSOLE=y
CONFIG_UART_CONSOLE=y
CONFIG_STDOUT_CONSOLE=y
CONFIG_PRINTK=y
CONFIG_SERIAL=y
CONFIG_VIDEO=y
CONFIG_I2C=y
CONFIG_I2C_TARGET=y
CONFIG_I2C_DW_CLOCK_SPEED=100
CONFIG_ARM_ETHOS_U=y
CONFIG_ARM_ETHOS_U_LOG_LEVEL_ERR=y
CONFIG_ASSERT=n
CONFIG_FAULT_DUMP=2
CONFIG_FPU=y
CONFIG_FP_HARDABI=y
CONFIG_TIMESLICING=y
CONFIG_TIMESLICE_SIZE=1
CONFIG_TIMESLICE_PRIORITY=5
CONFIG_FLASH_LOAD_OFFSET=0x400000
```

## vision.conf
```kconfig
CONFIG_DUAL_TFLM_LIVE_VISION=y
CONFIG_VIDEO=y
CONFIG_VIDEO_MIPI_CSI2_DW=y
CONFIG_VIDEO_ALIF_CAM_EXTENDED=y
CONFIG_MT9M114_PARALLEL_INIT=n
CONFIG_USE_ALIF_ISP_LIB=y
CONFIG_ISP_LIB_SCALAR_MODULE=y
CONFIG_ISP_LIB_DMSC_MODULE=y
CONFIG_ISP_LIB_CCM_MODULE=n
CONFIG_ISP_LIB_WBM_MODULE=n
CONFIG_ISP_LIB_WB_MODULE=n
CONFIG_VIDEO_BUFFER_POOL_SZ_MAX=650000
CONFIG_VIDEO_BUFFER_POOL_NUM_MAX=5
CONFIG_INIT_STACKS=y
CONFIG_I2C=y
CONFIG_I2C_TARGET=y
CONFIG_I2C_DW_CLOCK_SPEED=100
CONFIG_REGULATOR=y
CONFIG_REGULATOR_FIXED_INIT_PRIORITY=40
CONFIG_MIPI_DSI=y
CONFIG_DISPLAY=y
CONFIG_GPIO_HOGS=y
CONFIG_LOG=y
CONFIG_LOG_DEFAULT_LEVEL=3
```

## boards/dual_npu_e8.overlay
```dts
/*
 * Alif E8 dual-NPU resources for the RTSS-HP live vision demo.
 * The application supplies the multi-variant core-driver instances.
 */

&ethosu0 {
	compatible = "ethos-multinpu,probe";
	status = "okay";
};

&ethosu1 {
	compatible = "ethos-multinpu,probe";
	status = "okay";
};

&sram1 {
	status = "okay";
};

&aipm_off {
	vtor-address = <0x80400000>;
};
```

## src/main.cpp
```c
/* SPDX-License-Identifier: Apache-2.0 */

#include <algorithm>
#include <cmath>
#include <cstdint>
#include <cstring>

#include <tensorflow/lite/micro/micro_interpreter.h>
#include <tensorflow/lite/micro/micro_mutable_op_resolver.h>
#include <tensorflow/lite/schema/schema_generated.h>
#include <zephyr/cache.h>
#include <zephyr/kernel.h>
#include <zephyr/sys/printk.h>

#include "model_layout.h"

extern "C" int dual_ethosu_init(void);
extern "C" unsigned dual_ethosu_u55_irqs(void);
extern "C" unsigned dual_ethosu_u85_irqs(void);
extern "C" uint64_t dual_ethosu_u55_pmu_cycles(void);
extern "C" uint64_t dual_ethosu_u85_pmu_cycles(void);
extern "C" int zephyr_dual_display_init(void);
extern "C" int zephyr_dual_capture_preview(void);
extern "C" int zephyr_dual_release_frame(void);
extern "C" uint16_t *zephyr_dual_preview_buffer(void);
extern "C" void zephyr_dual_get_rgb(uint32_t, uint32_t, uint8_t *, uint8_t *, uint8_t *);
extern "C" void zephyr_dual_show_ssd_result(int);
extern "C" void zephyr_dual_show_classification(int, int, const char *);
extern "C" void zephyr_dual_reset_results(void);
extern "C" void zephyr_dual_clear_display(void);
extern "C" void zephyr_dual_show_parallel_summary(uint32_t, uint32_t, uint32_t,
                                                    uint32_t, uint32_t);
extern "C" void zephyr_dual_show_bmp(const uint8_t *);

namespace {

enum class Workload { FaceDetection, ImageClassification };
constexpr uintptr_t kPayloadAddress = 0x80008000U;
constexpr uintptr_t kU85ModelAddress = kPayloadAddress;
constexpr uintptr_t kU55ModelAddress = kU85ModelAddress + U85_MODEL_SIZE;
constexpr uintptr_t kFaceBmpAddress = kU55ModelAddress + U55_MODEL_SIZE;
constexpr uintptr_t kClassLabelsAddress = kFaceBmpAddress + FACE_BMP_SIZE;
constexpr size_t kPayloadSize = U85_MODEL_SIZE + U55_MODEL_SIZE + FACE_BMP_SIZE +
                                CLASS_LABELS_SIZE;
constexpr size_t kLiveWidth = 480U;
constexpr size_t kLiveHeight = 352U;
const uint8_t *const u85_model = reinterpret_cast<const uint8_t *>(kU85ModelAddress);
const uint8_t *const u55_model = reinterpret_cast<const uint8_t *>(kU55ModelAddress);

/* Vela reports 258 KiB for SSD and 1475 KiB for MobileNetV2. */
alignas(32) uint8_t u55_tensor_arena[384U * 1024U];
__attribute__((section(".alif_sram1.tensor_arena"), aligned(32)))
uint8_t u85_tensor_arena[1792U * 1024U];

uint16_t *live_frame;
volatile bool use_test_image = true;
volatile int latest_class_id;
volatile int latest_class_confidence;
char latest_class_label[18];
volatile int execute_status[2] = {-1, -1};
volatile uint64_t execute_start_cycles[2], execute_end_cycles[2];
volatile uint64_t prepare_start_cycles[2], prepare_ready_cycles[2];

K_THREAD_STACK_DEFINE(u55_thread_stack, 32768);
K_THREAD_STACK_DEFINE(u85_thread_stack, 32768);
struct k_thread u55_thread, u85_thread;
K_SEM_DEFINE(u55_start_sem, 0, 1);
K_SEM_DEFINE(u85_start_sem, 0, 1);
K_SEM_DEFINE(execute_ready_sem, 0, 2);
K_SEM_DEFINE(u55_execute_go_sem, 0, 1);
K_SEM_DEFINE(u85_execute_go_sem, 0, 1);
K_SEM_DEFINE(done_sem, 0, 2);
K_SEM_DEFINE(input_copied_sem, 0, 2);

void live_rgb(size_t x, size_t y, uint8_t &red, uint8_t &green, uint8_t &blue) {
  if (use_test_image) {
    const auto *bmp = reinterpret_cast<const uint8_t *>(kFaceBmpAddress);
    const size_t bx = x * 192U / kLiveWidth;
    const size_t by = 191U - y * 192U / kLiveHeight;
    const size_t offset = 54U + (by * 192U + bx) * 3U;
    blue = bmp[offset]; green = bmp[offset + 1U]; red = bmp[offset + 2U];
  } else {
    zephyr_dual_get_rgb(static_cast<uint32_t>(x), static_cast<uint32_t>(y),
                        &red, &green, &blue);
  }
}

void populate_input(TfLiteTensor *input, Workload workload) {
  auto *image = input->data.int8;
  if (input->dims == nullptr || input->dims->size != 4) return;
  const bool nchw = input->dims->data[1] == 1 || input->dims->data[1] == 3;
  const size_t channels = static_cast<size_t>(input->dims->data[nchw ? 1 : 3]);
  const size_t height = static_cast<size_t>(input->dims->data[nchw ? 2 : 1]);
  const size_t width = static_cast<size_t>(input->dims->data[nchw ? 3 : 2]);
  auto quantize_real = [input](float real) {
    const int q = static_cast<int>(roundf(real / input->params.scale)) +
                  input->params.zero_point;
    return static_cast<int8_t>(std::clamp(q, -128, 127));
  };
  for (size_t y = 0; y < height; ++y) {
    const size_t sy = y * kLiveHeight / height;
    for (size_t x = 0; x < width; ++x) {
      uint8_t red, green, blue;
      live_rgb(x * kLiveWidth / width, sy, red, green, blue);
      if (workload == Workload::FaceDetection) {
        const int gray = static_cast<int>((77U * red + 150U * green + 29U * blue) >> 8);
        const size_t offset = nchw ? y * width + x : (y * width + x) * channels;
        image[offset] = quantize_real(static_cast<float>(gray) / 255.0f);
      } else {
        const uint8_t rgb[3] = {red, green, blue};
        constexpr float mean[3] = {0.485f, 0.456f, 0.406f};
        constexpr float stddev[3] = {0.229f, 0.224f, 0.225f};
        for (size_t channel = 0; channel < channels; ++channel) {
          const size_t offset = nchw ? (channel * height + y) * width + x
                                     : (y * width + x) * channels + channel;
          const float normalized =
              (static_cast<float>(rgb[channel]) / 255.0f - mean[channel]) /
              stddev[channel];
          image[offset] = quantize_real(normalized);
        }
      }
    }
  }
  sys_cache_data_flush_range(image, input->bytes);
}

struct Detection { float x0, y0, x1, y1, score; };
Detection latest_detections[10];
size_t latest_detection_count;

void render_ssd(TfLiteTensor *outputs[2], bool log_results) {
  Detection candidates[64];
  size_t count = 0;
  TfLiteTensor *boxes = nullptr;
  TfLiteTensor *scores = nullptr;
  for (TfLiteTensor *output : {outputs[0], outputs[1]}) {
    if (output == nullptr || output->dims == nullptr || output->dims->size != 3)
      continue;
    const int columns = output->dims->data[2];
    if (columns == 4) boxes = output;
    if (columns == 2) scores = output;
  }
  if (boxes == nullptr || scores == nullptr || boxes->type != kTfLiteInt8 ||
      scores->type != kTfLiteInt8) return;
  sys_cache_data_invd_range(boxes->data.raw, boxes->bytes);
  sys_cache_data_invd_range(scores->data.raw, scores->bytes);
  const int feature_h[4] = {15, 8, 4, 2};
  const int feature_w[4] = {20, 10, 5, 3};
  const int anchor_count[4] = {3, 2, 2, 3};
  const float min_boxes[4][3] = {{10, 16, 24}, {32, 48, 0},
                                  {64, 96, 0}, {128, 192, 256}};
  size_t index = 0;
  for (size_t level = 0; level < 4; ++level) {
    for (int y = 0; y < feature_h[level]; ++y) {
      for (int x = 0; x < feature_w[level]; ++x) {
        for (int anchor = 0; anchor < anchor_count[level]; ++anchor, ++index) {
          const float background =
              (static_cast<int>(scores->data.int8[index * 2U]) -
               scores->params.zero_point) * scores->params.scale;
          const float face =
              (static_cast<int>(scores->data.int8[index * 2U + 1U]) -
               scores->params.zero_point) * scores->params.scale;
          const float score = 1.0f / (1.0f + expf(std::clamp(background - face,
                                                             -16.0f, 16.0f)));
          if (score < 0.70f || count == ARRAY_SIZE(candidates)) continue;
          auto loc = [&](size_t field) {
            return (static_cast<int>(boxes->data.int8[index * 4U + field]) -
                    boxes->params.zero_point) * boxes->params.scale;
          };
          const float aw = min_boxes[level][anchor] / 160.0f;
          const float ah = min_boxes[level][anchor] / 120.0f;
          const float acx = (static_cast<float>(x) + 0.5f) / feature_w[level];
          const float acy = (static_cast<float>(y) + 0.5f) / feature_h[level];
          const float cx = acx + loc(0) * 0.1f * aw;
          const float cy = acy + loc(1) * 0.1f * ah;
          const float width = aw * expf(loc(2) * 0.2f);
          const float height = ah * expf(loc(3) * 0.2f);
          candidates[count++] = {(cx - width / 2.0f) * 192.0f,
                                 (cy - height / 2.0f) * 192.0f,
                                 (cx + width / 2.0f) * 192.0f,
                                 (cy + height / 2.0f) * 192.0f, score};
        }
      }
    }
  }
  std::sort(candidates, candidates + count,
            [](const Detection &a, const Detection &b) { return a.score > b.score; });
  latest_detection_count = 0;
  for (size_t i = 0; i < count && latest_detection_count < ARRAY_SIZE(latest_detections); ++i) {
    bool suppressed = false;
    for (size_t j = 0; j < latest_detection_count; ++j) {
      const float ix0 = fmaxf(candidates[i].x0, latest_detections[j].x0);
      const float iy0 = fmaxf(candidates[i].y0, latest_detections[j].y0);
      const float ix1 = fminf(candidates[i].x1, latest_detections[j].x1);
      const float iy1 = fminf(candidates[i].y1, latest_detections[j].y1);
      const float intersection = fmaxf(0, ix1 - ix0) * fmaxf(0, iy1 - iy0);
      const float area_a = (candidates[i].x1 - candidates[i].x0) *
                           (candidates[i].y1 - candidates[i].y0);
      const float area_b = (latest_detections[j].x1 - latest_detections[j].x0) *
                           (latest_detections[j].y1 - latest_detections[j].y0);
      const float iou = intersection / (area_a + area_b - intersection);
      const float overlap_min = intersection / fminf(area_a, area_b);
      /* SSD-Slim emits differently sized anchors around one face. Retain
       * standard IoU NMS and reject near-contained offset proposals. */
      if (iou > 0.30f || overlap_min > 0.60f) {
        suppressed = true; break;
      }
    }
    if (!suppressed) latest_detections[latest_detection_count++] = candidates[i];
  }
  if (log_results) printk("dual-tflm: SSD faces=%zu candidates=%zu\n", latest_detection_count, count);
  zephyr_dual_show_ssd_result(static_cast<int>(latest_detection_count));
  for (size_t i = 0; i < latest_detection_count; ++i) {
    if (log_results)
      printk("dual-tflm: face %zu score=%d%% box=(%d,%d)-(%d,%d)\n", i,
             static_cast<int>(latest_detections[i].score * 100),
             static_cast<int>(latest_detections[i].x0), static_cast<int>(latest_detections[i].y0),
             static_cast<int>(latest_detections[i].x1), static_cast<int>(latest_detections[i].y1));
    const int width = static_cast<int>(kLiveHeight);
    const int xoff = (static_cast<int>(kLiveWidth) - width) / 2;
    int x0 = std::clamp(xoff + static_cast<int>(latest_detections[i].x0 * width / 192), 0, 479);
    int x1 = std::clamp(xoff + static_cast<int>(latest_detections[i].x1 * width / 192), 0, 479);
    int y0 = std::clamp(static_cast<int>(latest_detections[i].y0 * kLiveHeight / 192), 0, 351);
    int y1 = std::clamp(static_cast<int>(latest_detections[i].y1 * kLiveHeight / 192), 0, 351);
    if (x1 > x0 && y1 > y0) for (int t = 0; t < 3; ++t) {
      for (int x = x0; x <= x1; ++x) {
        live_frame[(y0 + t) * kLiveWidth + x] = 0x07e0;
        live_frame[(y1 - t) * kLiveWidth + x] = 0x07e0;
      }
      for (int y = y0; y <= y1; ++y) {
        live_frame[y * kLiveWidth + x0 + t] = 0x07e0;
        live_frame[y * kLiveWidth + x1 - t] = 0x07e0;
      }
    }
  }
  sys_cache_data_flush_range(live_frame, kLiveWidth * kLiveHeight * 2U);
}

void lookup_class_label(size_t class_id, char *label, size_t capacity) {
  const char *text = reinterpret_cast<const char *>(kClassLabelsAddress);
  size_t current = 0;
  while (current < class_id && static_cast<size_t>(text - reinterpret_cast<const char *>(kClassLabelsAddress)) < CLASS_LABELS_SIZE) {
    if (*text++ == '\n') ++current;
  }
  size_t used = 0;
  while (used + 1U < capacity && *text != '\n' && *text != ',' && *text != '\0') {
    char c = *text++;
    label[used++] = (c >= 'a' && c <= 'z') ? static_cast<char>(c - 'a' + 'A') : c;
  }
  label[used] = '\0';
}

int run_model(const char *name, const uint8_t *model_data,
              uint8_t *arena, size_t arena_size,
              Workload workload, size_t worker_id) {
  struct k_sem *go = worker_id == 0 ? &u55_execute_go_sem : &u85_execute_go_sem;
  prepare_start_cycles[worker_id] = k_cycle_get_64();
  auto setup_failed = [&](int status) {
    execute_status[worker_id] = status;
    prepare_ready_cycles[worker_id] = k_cycle_get_64();
    printk("dual-tflm: %s setup failed rc=%d\n", name, status);
    k_sem_give(&execute_ready_sem);
    return status;
  };
  const tflite::Model *model = tflite::GetModel(model_data);
  if (model->version() != TFLITE_SCHEMA_VERSION) return setup_failed(1);
  tflite::MicroMutableOpResolver<1> resolver;
  if (resolver.AddEthosU() != kTfLiteOk) return setup_failed(2);
  tflite::MicroInterpreter interpreter(model, resolver, arena, arena_size);
  if (interpreter.AllocateTensors() != kTfLiteOk) {
    printk("dual-tflm: %s AllocateTensors failed arena=%p/%zu\n", name, arena, arena_size);
    return setup_failed(3);
  }
  TfLiteTensor *input = interpreter.input(0);
  if (input == nullptr || input->type != kTfLiteInt8) return setup_failed(4);
  printk("dual-tflm: %s ready arena=%p/%zu input=%p/%zu outputs=%zu\n",
         name, arena, arena_size, input->data.raw, input->bytes,
         interpreter.outputs_size());
  prepare_ready_cycles[worker_id] = k_cycle_get_64();
  execute_status[worker_id] = 0;

  for (size_t iteration = 0;; ++iteration) {
    k_sem_give(&execute_ready_sem);
    k_sem_take(go, K_FOREVER);
    populate_input(input, workload);
    TfLiteTensor *classification_output = nullptr;
    if (workload == Workload::ImageClassification) {
      classification_output = interpreter.output(0);
    }
    if (!use_test_image) k_sem_give(&input_copied_sem);
    execute_start_cycles[worker_id] = k_cycle_get_64();
    const TfLiteStatus status = interpreter.Invoke();
    execute_end_cycles[worker_id] = k_cycle_get_64();
    execute_status[worker_id] = status == kTfLiteOk ? 0 : 5;
    if (status == kTfLiteOk && workload == Workload::ImageClassification) {
      TfLiteTensor *output = classification_output;
      sys_cache_data_invd_range(output->data.raw, output->bytes);
      const int8_t *scores = output->data.int8;
      size_t best = 0;
      for (size_t i = 1; i < output->bytes; ++i)
        if (scores[i] > scores[best]) best = i;
      latest_class_id = static_cast<int>(best);
      const float best_value =
          (static_cast<int>(scores[best]) - output->params.zero_point) *
          output->params.scale;
      if (output->params.zero_point == -128 &&
          output->params.scale <= (1.0f / 128.0f)) {
        /* The comparable MobileNetV2 includes Softmax and uses the same
         * quantized-probability contract as the known-good Arm ML-zoo model. */
        latest_class_confidence = std::clamp(
            static_cast<int>(roundf(best_value * 100.0f)), 0, 100);
      } else {
        float probability_sum = 0.0f;
        for (size_t i = 0; i < output->bytes; ++i) {
          const float relative_logit =
              (static_cast<int>(scores[i]) - static_cast<int>(scores[best])) *
              output->params.scale;
          probability_sum += expf(relative_logit);
        }
        latest_class_confidence = probability_sum > 0.0f
            ? std::clamp(static_cast<int>(roundf(100.0f / probability_sum)), 0, 100)
            : 0;
      }
      lookup_class_label(best, latest_class_label, sizeof(latest_class_label));
      zephyr_dual_show_classification(latest_class_id, latest_class_confidence,
                                      latest_class_label);
      if (iteration < 12U || iteration % 30U == 0U)
        printk("dual-tflm: frame=%zu CLASS=%d %s confidence=%d%% raw=%d\n",
               iteration, latest_class_id, latest_class_label,
               latest_class_confidence, scores[best]);
    } else if (status == kTfLiteOk) {
      TfLiteTensor *outputs[2] = {interpreter.output(0), interpreter.output(1)};
      render_ssd(outputs, iteration % 30U == 0U);
    }
    k_sem_give(&done_sem);
  }
}

void u55_thread_entry(void *, void *, void *) {
  k_sem_take(&u55_start_sem, K_FOREVER);
  (void)run_model("U55-SSD", u55_model, u55_tensor_arena,
                  sizeof(u55_tensor_arena), Workload::FaceDetection, 0);
}
void u85_thread_entry(void *, void *, void *) {
  k_sem_take(&u85_start_sem, K_FOREVER);
  (void)run_model("U85-MV2", u85_model, u85_tensor_arena,
                  sizeof(u85_tensor_arena), Workload::ImageClassification, 1);
}

}  // namespace

int main(void) {
  printk("*** dual TFLite Micro parallel SSD(U55) + MobileNetV2(U85) ***\n");
  if (zephyr_dual_display_init() != 0) {
    printk("dual-tflm: display/camera initialization failed\n");
    return 1;
  }
  live_frame = zephyr_dual_preview_buffer();
  sys_cache_data_invd_range(reinterpret_cast<void *>(kPayloadAddress), kPayloadSize);
  const auto *u85 = reinterpret_cast<const volatile uint8_t *>(kU85ModelAddress);
  const auto *u55 = reinterpret_cast<const volatile uint8_t *>(kU55ModelAddress);
  const auto *bmp = reinterpret_cast<const volatile uint16_t *>(kFaceBmpAddress);
  if (u85[4] != 'T' || u85[5] != 'F' || u85[6] != 'L' || u85[7] != '3' ||
      u55[4] != 'T' || u55[5] != 'F' || u55[6] != 'L' || u55[7] != '3' ||
      bmp[0] != 0x4d42U) {
    printk("dual-tflm: payload invalid\n");
    return 1;
  }
  printk("dual-tflm: models U55=%p/%u U85=%p/%u BMP=%p/%u\n",
         u55_model, U55_MODEL_SIZE, u85_model, U85_MODEL_SIZE,
         reinterpret_cast<const void *>(kFaceBmpAddress), FACE_BMP_SIZE);
  if (dual_ethosu_init() != 0) {
    printk("dual-tflm: NPU initialization failed\n");
    return 1;
  }
  zephyr_dual_show_bmp(reinterpret_cast<const uint8_t *>(kFaceBmpAddress));
  printk("dual-tflm: startup self-test image displayed\n");

  k_thread_create(&u55_thread, u55_thread_stack,
                  K_THREAD_STACK_SIZEOF(u55_thread_stack), u55_thread_entry,
                  nullptr, nullptr, nullptr, 5, 0, K_NO_WAIT);
  k_thread_create(&u85_thread, u85_thread_stack,
                  K_THREAD_STACK_SIZEOF(u85_thread_stack), u85_thread_entry,
                  nullptr, nullptr, nullptr, 4, 0, K_NO_WAIT);
  k_sem_give(&u55_start_sem);
  k_sem_take(&execute_ready_sem, K_FOREVER);
  k_sem_give(&u85_start_sem);
  k_sem_take(&execute_ready_sem, K_FOREVER);
  printk("dual-tflm: prepare U55=%llu us U85=%llu us\n",
         (unsigned long long)k_cyc_to_us_floor64(prepare_ready_cycles[0] - prepare_start_cycles[0]),
         (unsigned long long)k_cyc_to_us_floor64(prepare_ready_cycles[1] - prepare_start_cycles[1]));
  if (execute_status[0] != 0 || execute_status[1] != 0) {
    printk("dual-tflm: model setup failed U55=%d U85=%d\n",
           execute_status[0], execute_status[1]);
    return 1;
  }

  k_sem_give(&u55_execute_go_sem);
  k_sem_take(&done_sem, K_FOREVER);
  k_sem_take(&execute_ready_sem, K_FOREVER);
  k_sem_give(&u85_execute_go_sem);
  k_sem_take(&done_sem, K_FOREVER);
  k_sem_take(&execute_ready_sem, K_FOREVER);
  if (execute_status[0] != 0 || execute_status[1] != 0) {
    printk("dual-tflm: preflight failed U55=%d U85=%d\n",
           execute_status[0], execute_status[1]);
    return 1;
  }
  printk("dual-tflm: startup self-test passed; switching to camera in 5 seconds\n");
  k_msleep(5000);
  zephyr_dual_clear_display();
  use_test_image = false;
  zephyr_dual_reset_results();
  printk("dual-tflm: live dual-NPU pipeline started\n");

  constexpr size_t kWindow = 16U;
  uint32_t ru55[kWindow] = {}, ru85[kWindow] = {}, rspan[kWindow] = {}, roverlap[kWindow] = {};
  uint64_t su55 = 0, su85 = 0, sspan = 0, soverlap = 0;
  size_t ri = 0, count = 0;
  for (size_t frame = 1;; ++frame) {
    const int capture_rc = zephyr_dual_capture_preview();
    if (capture_rc != 0) {
      printk("dual-tflm: frame=%zu capture failed rc=%d\n", frame, capture_rc);
      k_msleep(100);
      continue;
    }
    k_sem_give(&u85_execute_go_sem);
    k_sem_give(&u55_execute_go_sem);
    k_sem_take(&input_copied_sem, K_FOREVER);
    k_sem_take(&input_copied_sem, K_FOREVER);
    const int release_rc = zephyr_dual_release_frame();
    if (release_rc != 0)
      printk("dual-tflm: frame=%zu release failed rc=%d\n", frame, release_rc);
    k_sem_take(&done_sem, K_FOREVER);
    k_sem_take(&done_sem, K_FOREVER);
    if (execute_status[0] != 0 || execute_status[1] != 0) {
      printk("dual-tflm: frame=%zu inference failed U55=%d U85=%d\n",
             frame, execute_status[0], execute_status[1]);
      return 1;
    }
    k_sem_take(&execute_ready_sem, K_FOREVER);
    k_sem_take(&execute_ready_sem, K_FOREVER);
    const uint64_t u55_us = k_cyc_to_us_floor64(execute_end_cycles[0] - execute_start_cycles[0]);
    const uint64_t u85_us = k_cyc_to_us_floor64(execute_end_cycles[1] - execute_start_cycles[1]);
    const uint64_t first = std::min(execute_start_cycles[0], execute_start_cycles[1]);
    const uint64_t last = std::max(execute_end_cycles[0], execute_end_cycles[1]);
    const uint64_t os = std::max(execute_start_cycles[0], execute_start_cycles[1]);
    const uint64_t oe = std::min(execute_end_cycles[0], execute_end_cycles[1]);
    const uint64_t span_us = k_cyc_to_us_floor64(last - first);
    const uint64_t overlap_us = oe > os ? k_cyc_to_us_floor64(oe - os) : 0U;
    if (count == kWindow) {
      su55 -= ru55[ri]; su85 -= ru85[ri]; sspan -= rspan[ri]; soverlap -= roverlap[ri];
    } else ++count;
    ru55[ri] = static_cast<uint32_t>(u55_us);
    ru85[ri] = static_cast<uint32_t>(u85_us);
    rspan[ri] = static_cast<uint32_t>(span_us);
    roverlap[ri] = static_cast<uint32_t>(overlap_us);
    su55 += u55_us; su85 += u85_us; sspan += span_us; soverlap += overlap_us;
    ri = (ri + 1U) % kWindow;
    zephyr_dual_show_parallel_summary(static_cast<uint32_t>(count),
        static_cast<uint32_t>(su55 / count), static_cast<uint32_t>(su85 / count),
        static_cast<uint32_t>(sspan / count), static_cast<uint32_t>(soverlap / count));
    if (frame == 1U || frame % 10U == 0U)
      printk("dual-tflm: PAR class=%d/%s frame=%zu U55=%llu U85=%llu "
             "span=%llu overlap=%llu us NPU-active U55/U85=%llu/%llu cycles\n",
             latest_class_id, latest_class_label, frame,
             (unsigned long long)u55_us, (unsigned long long)u85_us,
             (unsigned long long)span_us, (unsigned long long)overlap_us,
             (unsigned long long)dual_ethosu_u55_pmu_cycles(),
             (unsigned long long)dual_ethosu_u85_pmu_cycles());
    if (frame % 30U == 0U)
      printk("dual-tflm: live frame=%zu IRQs=%u/%u\n", frame,
             dual_ethosu_u55_irqs(), dual_ethosu_u85_irqs());
  }
}
```

## src/board_init.c
```c
/* SPDX-License-Identifier: Apache-2.0 */

#include <zephyr/device.h>
#include <zephyr/drivers/gpio.h>
#include <zephyr/init.h>
#include <zephyr/sys/__assert.h>
#include <zephyr/sys/sys_io.h>

#include <se_service.h>
#include <soc_common.h>

/*
 * Native E8 camera/display setup from the Alif SDK main branch. This must run directly
 * after the SE service (priority 45) and before the camera/DSI devices.
 * Keep both NPU clocks enabled for this dual-NPU variant.
 */
static int dual_native_set_parameters(void)
{
	run_profile_t runp = {0};
	int rc;

#if DT_NODE_HAS_STATUS(DT_NODELABEL(camera_select), okay)
	const struct gpio_dt_spec sel =
		GPIO_DT_SPEC_GET(DT_NODELABEL(camera_select), select_gpios);
	(void)gpio_pin_configure_dt(&sel, GPIO_OUTPUT);
	(void)gpio_pin_set_dt(&sel, 1);
#endif

#if defined(CONFIG_ENSEMBLE_GEN2) && defined(CONFIG_MIPI_DSI)
	const struct gpio_dt_spec mux =
		GPIO_DT_SPEC_GET(DT_NODELABEL(mipi_dsi), cam_disp_mux_gpios);
	(void)gpio_pin_configure_dt(&mux, GPIO_OUTPUT_ACTIVE);
#endif

	runp.power_domains = PD_SYST_MASK | PD_SSE700_AON_MASK | PD_DBSS_MASK;
	runp.dcdc_voltage = 825;
	runp.dcdc_mode = DCDC_MODE_PWM;
	runp.aon_clk_src = CLK_SRC_LFXO;
	runp.run_clk_src = CLK_SRC_PLL;
	runp.vdd_ioflex_3V3 = IOFLEX_LEVEL_1V8;
	runp.cpu_clk_freq = CLOCK_FREQUENCY_400MHZ;
	runp.memory_blocks = MRAM_MASK;
#if DT_NODE_EXISTS(DT_NODELABEL(sram0))
	runp.memory_blocks |= SRAM0_MASK;
#endif
#if DT_NODE_EXISTS(DT_NODELABEL(sram1))
	runp.memory_blocks |= SRAM1_MASK;
#endif
	runp.phy_pwr_gating = MIPI_TX_DPHY_MASK | MIPI_RX_DPHY_MASK |
		MIPI_PLL_DPHY_MASK | LDO_PHY_MASK;
	runp.ip_clock_gating = CDC200_MASK | CAMERA_MASK | MIPI_CSI_MASK |
		MIPI_DSI_MASK | NPU_HP_MASK | NPU_HE_MASK;

	rc = se_service_set_run_cfg(&runp);
	__ASSERT(rc == 0, "SE: set_run_cfg failed = %d", rc);
	if (rc != 0) {
		return rc;
	}

	sys_write32(0x140001, CLKCTRL_PER_MST_CAMERA_PIXCLK_CTRL);
	return 0;
}

SYS_INIT(dual_native_set_parameters, PRE_KERNEL_1, 46);
```

## src/ethosu_platform.c
```c
/* SPDX-License-Identifier: Apache-2.0 */

#include <stdlib.h>
#include <cmsis_core.h>
#include <ethosu_device.h>
#include <ethosu_driver.h>
#include <pmu_ethosu.h>
#include <soc_memory_map.h>
#include <zephyr/devicetree.h>
#include <zephyr/cache.h>
#include <zephyr/irq.h>
#include <zephyr/kernel.h>

#define U55_NODE DT_NODELABEL(ethosu0)
#define U85_NODE DT_NODELABEL(ethosu1)

static struct ethosu_driver u55_driver;
static struct ethosu_driver u85_driver;
static volatile unsigned u55_irqs;
static volatile unsigned u85_irqs;
static volatile uint64_t u55_pmu_cycles;
static volatile uint64_t u85_pmu_cycles;

void *ethosu_mutex_create(void)
{
	struct k_mutex *m = malloc(sizeof(*m));
	if (m != NULL) {
		k_mutex_init(m);
	}
	return m;
}

void ethosu_mutex_destroy(void *mutex) { free(mutex); }
int ethosu_mutex_lock(void *mutex) { return k_mutex_lock(mutex, K_FOREVER); }
int ethosu_mutex_unlock(void *mutex) { return k_mutex_unlock(mutex); }

void *ethosu_semaphore_create(void)
{
	struct k_sem *s = malloc(sizeof(*s));
	if (s != NULL) {
		/* Core-driver main owns the semaphore policy: waiters start empty and
		 * may accumulate one token per registered NPU of the same variant.
		 */
		k_sem_init(s, 0, K_SEM_MAX_LIMIT);
	}
	return s;
}

void ethosu_semaphore_destroy(void *sem) { free(sem); }

int ethosu_semaphore_take(void *sem, uint64_t timeout)
{
	k_timeout_t t = timeout == ETHOSU_SEMAPHORE_WAIT_FOREVER ? K_FOREVER : K_TICKS(timeout);
	return k_sem_take(sem, t);
}

int ethosu_semaphore_give(void *sem)
{
	k_sem_give(sem);
	return 0;
}

static uint64_t alif_address_remap(uint64_t address, int index)
{
	ARG_UNUSED(index);
	return local_to_global((void *)(uintptr_t)address);
}

static unsigned int alif_u85_config_select(uint64_t address, int index)
{
	/* HP DTCM is exposed to the NPUs at its 0x50800000 global alias and
	 * shared SRAM0/SRAM1 occupy 0x02000000-0x027fffff. All must be reached
	 * through U85's SRAM AXI interface (MEM_ATTR 0).
	 */
	if ((address >= DTCM_GLOBAL_BASE &&
	     address < DTCM_GLOBAL_BASE + DTCM_SIZE) ||
	    (address >= 0x02000000ULL && address < 0x02800000ULL)) {
		return 0;
	}
	if (address >= 0x80000000ULL) {
		/* MRAM/OSPI is reached through U85's EXT AXI interface. */
		return 2;
	}

	/* Preserve the U85 backend defaults for non-DTCM regions. */
	if (index < 0) {
		return 2;
	}
	return index == 0 ? 3 : 1;
}

static struct ethosu_device_user_ops alif_u55_user_ops = {
	.address_remap = alif_address_remap,
	.config_select = NULL,
};

static struct ethosu_device_user_ops alif_u85_user_ops = {
	.address_remap = alif_address_remap,
	.config_select = alif_u85_config_select,
};

void ethosu_flush_dcache(const uint64_t *base, const size_t *sizes, int count)
{
	for (int i = 0; i < count; ++i) {
		SCB_CleanDCache_by_Addr((uint32_t *)(uintptr_t)base[i], sizes[i]);
	}
}

void ethosu_invalidate_dcache(const uint64_t *base, const size_t *sizes, int count)
{
	for (int i = 0; i < count; ++i) {
		SCB_InvalidateDCache_by_Addr((uint32_t *)(uintptr_t)base[i], sizes[i]);
	}
}

static void u55_isr(const void *unused)
{
	ARG_UNUSED(unused);
	u55_irqs++;
	ethosu_irq_handler(&u55_driver);
}

static void u85_isr(const void *unused)
{
	ARG_UNUSED(unused);
	u85_irqs++;
	ethosu_irq_handler(&u85_driver);
}

void ethosu_inference_begin(struct ethosu_driver *drv, void *user_arg)
{
	ARG_UNUSED(user_arg);
	ETHOSU_PMU_Enable(drv);
	ETHOSU_PMU_PMCCNTR_CFG_Set_Start_Event(drv, ETHOSU_PMU_NPU_ACTIVE);
	ETHOSU_PMU_PMCCNTR_CFG_Set_Stop_Event(drv, ETHOSU_PMU_NPU_IDLE);
	ETHOSU_PMU_CNTR_Enable(drv, ETHOSU_PMU_CCNT_Msk);
	ETHOSU_PMU_CYCCNT_Reset(drv);
}

void ethosu_inference_end(struct ethosu_driver *drv, void *user_arg)
{
	ARG_UNUSED(user_arg);
	uint64_t cycles = ETHOSU_PMU_Get_CCNTR(drv);
	ETHOSU_PMU_CNTR_Disable(drv, ETHOSU_PMU_CCNT_Msk);
	ETHOSU_PMU_Disable(drv);
	if (drv == &u55_driver) {
		u55_pmu_cycles = cycles;
	} else if (drv == &u85_driver) {
		u85_pmu_cycles = cycles;
	}
}

int dual_ethosu_init(void)
{
	int ret;

	ret = ethosu_init_ex(&u55_driver, &ethosu_device_desc_u55,
			     &ethosu_device_config_u55, &alif_u55_user_ops,
			     (void *)DT_REG_ADDR(U55_NODE), NULL, 0, 1, 1);
	if (ret != 0) {
		return ret;
	}

	ret = ethosu_init_ex(&u85_driver, &ethosu_device_desc_u85,
			     &ethosu_device_config_u85, &alif_u85_user_ops,
			     (void *)DT_REG_ADDR(U85_NODE), NULL, 0, 1, 1);
	if (ret != 0) {
		return ret;
	}

	IRQ_CONNECT(DT_IRQN(U55_NODE), 3, u55_isr, NULL, 0);
	IRQ_CONNECT(DT_IRQN(U85_NODE), 3, u85_isr, NULL, 0);
	irq_enable(DT_IRQN(U55_NODE));
	irq_enable(DT_IRQN(U85_NODE));
	return 0;
}

unsigned dual_ethosu_u55_irqs(void) { return u55_irqs; }
unsigned dual_ethosu_u85_irqs(void) { return u85_irqs; }
uint64_t dual_ethosu_u55_pmu_cycles(void) { return u55_pmu_cycles; }
uint64_t dual_ethosu_u85_pmu_cycles(void) { return u85_pmu_cycles; }
```

## src/zephyr_vision.c
```c
/* SPDX-License-Identifier: Apache-2.0 */

#include <errno.h>
#include <stdint.h>
#include <stdio.h>
#include <string.h>
#include <zephyr/cache.h>
#include <zephyr/device.h>
#include <zephyr/drivers/display.h>
#include <zephyr/drivers/display/cdc200.h>
#include <zephyr/drivers/mipi_dsi/dsi_dw.h>
#include <zephyr/drivers/video.h>
#include <zephyr/drivers/video/video_alif.h>
#include <zephyr/kernel.h>
#include <zephyr/sys/printk.h>

#define DISPLAY_WIDTH 480U
#define DISPLAY_HEIGHT 800U
#define PREVIEW_HEIGHT 352U
#define PREVIEW_Y (((DISPLAY_HEIGHT - PREVIEW_HEIGHT) / 2U) - 40U)
#define CAMERA_OUTPUT_WIDTH 192U
#define CAMERA_OUTPUT_HEIGHT 192U
#define PREVIEW_X ((DISPLAY_WIDTH - PREVIEW_HEIGHT) / 2U)
static const struct device *display_dev;
static const struct device *camera_dev;
static uint16_t *framebuffer;
static struct video_buffer *camera_buffer;
static struct video_buffer *camera_buffers[5];
static struct video_format camera_format;
static bool camera_started;
static bool camera_streaming;

/* Callback required by Alif's ISP wrapper. Keep the vendor library quiet;
 * Zephyr-side failures are still reported by the video driver. */
int log_level(void) { return 0; }

static int start_camera(void)
{
	struct video_caps caps;
	int rc;

	if (camera_started) return 0;
	/* Match the updated Alif reference pipeline: RAW10 from MT9M114 is
	 * demosaiced by the hardware ISP into planar RGB888. */
	camera_dev = DEVICE_DT_GET_ONE(vsi_isp_pico);
	if (!device_is_ready(camera_dev)) return -ENODEV;

	memset(&caps, 0, sizeof(caps));
	rc = video_get_caps(camera_dev, VIDEO_EP_IN, &caps);
	if (rc != 0) return rc;
	for (const struct video_format_cap *cap = caps.format_caps;
	     cap != NULL && cap->pixelformat != 0; ++cap) {
		if (cap->pixelformat == VIDEO_PIX_FMT_Y10P) {
			/* Match the PR reference: keep walking so the last Y10P
			 * capability (1288x728 for MT9M114) is selected.  The
			 * sensor-specific crop-x0=280 is invalid for 640x480. */
			camera_format.pixelformat = VIDEO_PIX_FMT_Y10P;
			camera_format.width = cap->width_min;
			camera_format.height = cap->height_min;
			camera_format.pitch = cap->width_min * 2U;
		}
	}
	if (camera_format.pixelformat == 0) return -ENOTSUP;
	printk("dual-tflm: ISP input selected %ux%u pitch=%u\n",
	       camera_format.width, camera_format.height, camera_format.pitch);
	rc = video_set_format(camera_dev, VIDEO_EP_IN, &camera_format);
	if (rc != 0) return rc;
	camera_format.pixelformat = VIDEO_PIX_FMT_RGB888_PLANAR_PRIVATE;
	/* The MT9M114-specific ISP overlay selects a centered 728x728 ROI.
	 * Keep the ISP output square as well; requesting 480x272 from that ROI is
	 * rejected by the updated ISP library and previously exposed invalid edge
	 * pixels as noise. */
	camera_format.width = CAMERA_OUTPUT_WIDTH;
	camera_format.height = CAMERA_OUTPUT_HEIGHT;
	camera_format.pitch = camera_format.width * 3U;
	rc = video_set_format(camera_dev, VIDEO_EP_OUT, &camera_format);
	if (rc != 0) return rc;
	const size_t capture_size = (size_t)camera_format.pitch * camera_format.height;

	for (size_t i = 0; i < ARRAY_SIZE(camera_buffers); ++i) {
		camera_buffers[i] = video_buffer_alloc(capture_size, K_NO_WAIT);
		if (camera_buffers[i] == NULL) return -ENOMEM;
		rc = video_enqueue(camera_dev, VIDEO_EP_OUT, camera_buffers[i]);
		if (rc != 0) return rc;
	}
	camera_started = true;
	printk("dual-tflm: Zephyr MT9M114 ready %ux%u pitch=%u buffers=%zu first=%p/%u\n",
	       camera_format.width, camera_format.height, camera_format.pitch,
	       ARRAY_SIZE(camera_buffers), camera_buffers[0]->buffer,
	       (unsigned)camera_buffers[0]->size);
	return 0;
}

int zephyr_dual_display_init(void)
{
	const struct device *panel = DEVICE_DT_GET(DT_ALIAS(panel));
	const struct device *dsi = DEVICE_DT_GET(DT_ALIAS(mipi_dsi));
	struct cdc200_fb_desc fb = {0};
	int rc;

	display_dev = DEVICE_DT_GET(DT_CHOSEN(zephyr_display));
	if (!device_is_ready(panel) || !device_is_ready(dsi) ||
	    !device_is_ready(display_dev)) return -ENODEV;
	rc = dsi_dw_set_mode(dsi, DSI_DW_VIDEO_MODE);
	if (rc == 0) rc = display_blanking_off(panel);
	if (rc != 0) return rc;
	cdc200_set_enable(display_dev, true);
	cdc200_get_framebuffer(display_dev, 0, &fb);
	if (fb.fb_addr == NULL || fb.fb_size < DISPLAY_WIDTH * DISPLAY_HEIGHT * 2U)
		return -ENOMEM;
	framebuffer = (uint16_t *)fb.fb_addr;
	memset(framebuffer, 0, DISPLAY_WIDTH * DISPLAY_HEIGHT * 2U);
	sys_cache_data_flush_range(framebuffer, DISPLAY_WIDTH * DISPLAY_HEIGHT * 2U);
	printk("dual-tflm: Zephyr MW405 ready fb=%p/%zu\n", fb.fb_addr, fb.fb_size);
	return start_camera();
}

uint16_t *zephyr_dual_preview_buffer(void)
{
	return framebuffer ? framebuffer + PREVIEW_Y * DISPLAY_WIDTH : NULL;
}

int zephyr_dual_capture_preview(void)
{
	struct video_buffer *captured = NULL;
	int rc = start_camera();
	if (rc != 0) return rc;

	/* Return the frame held stable during the previous inference, while four
	 * other buffers kept the continuously streaming CSI/CPI pipeline fed. */
	if (camera_buffer != NULL) {
		rc = video_enqueue(camera_dev, VIDEO_EP_OUT, camera_buffer);
		if (rc != 0) return rc;
		camera_buffer = NULL;
	}
	if (!camera_streaming) {
		rc = video_stream_start(camera_dev);
		if (rc != 0 && rc != -EBUSY) return rc;
		camera_streaming = true;
	}
	/* The Alif CPI driver can transiently return EAGAIN at a frame boundary
	 * even with a blocking timeout. Preserve the queued-buffer state and wait
	 * briefly for the next completed buffer instead of dropping the frame. */
	for (unsigned retry = 0; retry < 50U; ++retry) {
		rc = video_dequeue(camera_dev, VIDEO_EP_OUT, &captured, K_MSEC(100));
		if (rc != -EAGAIN) break;
	}
	if (rc != 0 || captured == NULL) return rc != 0 ? rc : -EIO;
	/* Inference is slower than the camera. Drain all already-completed frames,
	 * requeue stale ones, and retain only the newest frame. Without this step
	 * one completed buffer accumulates per iteration until the pool empties. */
	for (;;) {
		struct video_buffer *newer = NULL;
		rc = video_dequeue(camera_dev, VIDEO_EP_OUT, &newer, K_NO_WAIT);
		if (rc == -EAGAIN) break;
		if (rc != 0 || newer == NULL) return rc != 0 ? rc : -EIO;
		rc = video_enqueue(camera_dev, VIDEO_EP_OUT, captured);
		if (rc != 0) return rc;
		captured = newer;
	}
	camera_buffer = captured;
	sys_cache_data_invd_range(camera_buffer->buffer,
		(size_t)camera_format.pitch * camera_format.height);

	const size_t plane_size = (size_t)camera_format.width * camera_format.height;
	const uint8_t *red = camera_buffer->buffer;
	const uint8_t *green = red + plane_size;
	const uint8_t *blue = green + plane_size;
	for (uint32_t y = 0; y < PREVIEW_HEIGHT; ++y) {
		const uint32_t sy = y * camera_format.height / PREVIEW_HEIGHT;
		uint16_t *dst = framebuffer + (PREVIEW_Y + y) * DISPLAY_WIDTH;
		memset(dst, 0, DISPLAY_WIDTH * sizeof(*dst));
		for (uint32_t x = 0; x < PREVIEW_HEIGHT; ++x) {
			const uint32_t sx = x * camera_format.width / PREVIEW_HEIGHT;
			const size_t i = (size_t)sy * camera_format.width + sx;
			dst[PREVIEW_X + x] = ((uint16_t)(red[i] >> 3) << 11) |
				 ((uint16_t)(green[i] >> 2) << 5) | (blue[i] >> 3);
		}
	}
	sys_cache_data_flush_range(framebuffer + PREVIEW_Y * DISPLAY_WIDTH,
		PREVIEW_HEIGHT * DISPLAY_WIDTH * 2U);
	return 0;
}

int zephyr_dual_release_frame(void)
{
	if (camera_buffer == NULL) return 0;
	int rc = video_enqueue(camera_dev, VIDEO_EP_OUT, camera_buffer);
	if (rc == 0) camera_buffer = NULL;
	return rc;
}

void zephyr_dual_get_rgb(uint32_t x, uint32_t y,
			 uint8_t *red, uint8_t *green, uint8_t *blue)
{
	/* x is expressed in the logical 480x272 preview coordinate system used by
	 * both models. Scale it onto the centered square camera image. */
	const uint32_t sx = x * camera_format.width / DISPLAY_WIDTH;
	const uint32_t sy = y * camera_format.height / PREVIEW_HEIGHT;
	const size_t plane_size = (size_t)camera_format.width * camera_format.height;
	const size_t i = (size_t)sy * camera_format.width + sx;
	const uint8_t *planes = camera_buffer->buffer;
	*red = planes[i];
	*green = planes[plane_size + i];
	*blue = planes[2U * plane_size + i];
}

static void reload_display(void)
{
	sys_cache_data_flush_range(framebuffer, DISPLAY_WIDTH * DISPLAY_HEIGHT * 2U);
}

static void summary_text(uint32_t x, uint32_t y, const char *text, uint16_t color);
void zephyr_dual_clear_display(void)
{
	memset(framebuffer, 0, DISPLAY_WIDTH * DISPLAY_HEIGHT * 2U);
	reload_display();
}

static const uint8_t *summary_glyph(char c)
{
	static const uint8_t digits[10][7] = {
		{14,17,19,21,25,17,14},{4,12,4,4,4,4,14},{14,17,1,2,4,8,31},
		{30,1,1,14,1,1,30},{2,6,10,18,31,2,2},{31,16,16,30,1,1,30},
		{14,16,16,30,17,17,14},{31,1,2,4,8,8,8},{14,17,17,14,17,17,14},
		{14,17,17,15,1,1,14}};
	static const uint8_t letters[26][7] = {
		{14,17,17,31,17,17,17},{30,17,17,30,17,17,30},{14,17,16,16,16,17,14},
		{30,17,17,17,17,17,30},{31,16,16,30,16,16,31},{31,16,16,30,16,16,16},
		{14,17,16,23,17,17,15},{17,17,17,31,17,17,17},{14,4,4,4,4,4,14},
		{1,1,1,1,17,17,14},{17,18,20,24,20,18,17},{16,16,16,16,16,16,31},
		{17,27,21,21,17,17,17},{17,25,25,21,19,19,17},{14,17,17,17,17,17,14},
		{30,17,17,30,16,16,16},{14,17,17,17,21,18,13},{30,17,17,30,20,18,17},
		{15,16,16,14,1,1,30},{31,4,4,4,4,4,4},{17,17,17,17,17,17,14},
		{17,17,17,17,17,10,4},{17,17,17,21,21,21,10},{17,17,10,4,10,17,17},
		{17,17,10,4,4,4,4},{31,1,2,4,8,16,31}};
	static const uint8_t blank[7]={0};
	if (c >= '0' && c <= '9') return digits[c - '0'];
	if (c >= 'A' && c <= 'Z') return letters[c - 'A'];
	return blank;
}

static void summary_text(uint32_t x, uint32_t y, const char *text, uint16_t color)
{
	const uint32_t scale = 3U;
	for (; *text; ++text, x += 6U * scale) {
		const uint8_t *glyph = summary_glyph(*text);
		for (uint32_t row = 0; row < 7U; ++row)
			for (uint32_t col = 0; col < 5U; ++col)
				if (glyph[row] & BIT(4U-col))
					for (uint32_t dy=0; dy<scale; ++dy)
						for (uint32_t dx=0; dx<scale; ++dx)
							framebuffer[(y+row*scale+dy)*DISPLAY_WIDTH+x+col*scale+dx]=color;
	}
}

void zephyr_dual_show_ssd_result(int faces)
{
	char line[24];
	for (uint32_t y = 12U; y < 38U; ++y)
		memset(framebuffer + y * DISPLAY_WIDTH, 0, DISPLAY_WIDTH * sizeof(*framebuffer));
	snprintf(line, sizeof(line), "U55 SSD F %d", faces);
	summary_text(18U, 14U, line, faces > 0 ? 0x07e0 : 0xffff);
	reload_display();
}

void zephyr_dual_show_classification(int class_id, int confidence, const char *label)
{
	char line[28];
	for (uint32_t y = 42U; y < 70U; ++y)
		memset(framebuffer + y * DISPLAY_WIDTH, 0, DISPLAY_WIDTH * sizeof(*framebuffer));
	snprintf(line, sizeof(line), "U85 %s %d", label && label[0] ? label : "CLASS", confidence);
	summary_text(18U, 44U, line, class_id >= 0 ? 0x07ff : 0xffff);
	reload_display();
}

void zephyr_dual_reset_results(void)
{
	zephyr_dual_show_ssd_result(0);
	zephyr_dual_show_classification(-1, 0, "CLASS");
}

void zephyr_dual_show_parallel_summary(uint32_t samples, uint32_t u55_us,
	uint32_t u85_us, uint32_t span_us, uint32_t overlap_us)
{
	char line[24]; const uint32_t top=575U;
	for (uint32_t y=top; y<735U; ++y)
		for (uint32_t x=16U; x<464U; ++x) framebuffer[y*DISPLAY_WIDTH+x]=0;
	summary_text(24U,top,"PAR AVG US",0xffe0);
	snprintf(line,sizeof(line),"U55 %lu",(unsigned long)u55_us); summary_text(24U,top+28U,line,0xffff);
	snprintf(line,sizeof(line),"U85 %lu",(unsigned long)u85_us); summary_text(24U,top+56U,line,0xffff);
	snprintf(line,sizeof(line),"SPAN %lu",(unsigned long)span_us); summary_text(24U,top+84U,line,0x07ff);
	snprintf(line,sizeof(line),"OVLP %lu",(unsigned long)overlap_us); summary_text(24U,top+112U,line,overlap_us?0x07e0:0xf800);
	snprintf(line,sizeof(line),"N %lu",(unsigned long)samples); summary_text(300U,top,line,0xffff);
	reload_display();
}

void zephyr_dual_show_bmp(const uint8_t *bmp)
{
	const uint8_t *pixels=bmp+54U; const uint32_t size=PREVIEW_HEIGHT;
	const uint32_t xoff=(DISPLAY_WIDTH-size)/2U;
	for (uint32_t y=0; y<PREVIEW_HEIGHT; ++y) {
		memset(framebuffer+(PREVIEW_Y+y)*DISPLAY_WIDTH,0,DISPLAY_WIDTH*2U);
		for (uint32_t x=0; x<size; ++x) {
			uint32_t sx=x*192U/size, sy=191U-y*192U/size;
			const uint8_t *bgr=pixels+(sy*192U+sx)*3U;
			framebuffer[(PREVIEW_Y+y)*DISPLAY_WIDTH+xoff+x]=
				((uint16_t)(bgr[2]>>3)<<11)|((uint16_t)(bgr[1]>>2)<<5)|(bgr[0]>>3);
		}
	}
	reload_display();
}
```
