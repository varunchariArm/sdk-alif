## CMakeLists.txt
```
cmake_minimum_required(VERSION 3.20)

set(CMAKE_SKIP_INSTALL_RULES ON CACHE BOOL "" FORCE)
set(ETHOSU_MULTI_VARIANT ON CACHE BOOL "" FORCE)
set(CMSIS_PATH "$ENV{ZEPHYR_BASE}/../modules/hal/cmsis"
    CACHE PATH "" FORCE)

find_package(Zephyr REQUIRED HINTS $ENV{ZEPHYR_BASE})
project(executorch_dual_npu C CXX)

set(EXECUTORCH_ROOT ${ZEPHYR_EXECUTORCH_MODULE_DIR})
set(ET_PYTHON "${Python3_EXECUTABLE}")
set(MODEL_DIR "${CMAKE_CURRENT_LIST_DIR}/models")
set(U85_PTE "${MODEL_DIR}/mobilenet_v2_imagenet_u85.pte")
set(U55_PTE "${MODEL_DIR}/comparable_ssd_slim_u55.pte")
set(FACE_BMP "${MODEL_DIR}/grace_hopper.bmp")
set(CLASS_LABELS "${MODEL_DIR}/labels_imagenet_1000.txt")
set(MODEL_PAYLOAD "${CMAKE_CURRENT_BINARY_DIR}/model_assets.bin")

# The model sizes define the packed MRAM offsets compiled into model_layout.h.
# Reconfigure automatically when an artifact changes so an incremental build
# cannot combine a new payload with stale firmware offsets.
set_property(DIRECTORY APPEND PROPERTY CMAKE_CONFIGURE_DEPENDS
  "${U85_PTE}" "${U55_PTE}" "${FACE_BMP}" "${CLASS_LABELS}")

file(SIZE "${U85_PTE}" U85_PTE_SIZE)
file(SIZE "${U55_PTE}" U55_PTE_SIZE)
file(SIZE "${FACE_BMP}" FACE_BMP_SIZE)
file(SIZE "${CLASS_LABELS}" CLASS_LABELS_SIZE)
configure_file(src/model_layout.h.in
               "${CMAKE_CURRENT_BINARY_DIR}/model_layout.h" @ONLY)
if(CONFIG_DUAL_ET_LIVE_VISION)
  set(MODEL_PAYLOAD_INPUTS ${U85_PTE} ${U55_PTE} ${FACE_BMP} ${CLASS_LABELS})
else()
  set(MODEL_PAYLOAD_INPUTS ${U85_PTE} ${U55_PTE})
endif()
add_custom_command(
  OUTPUT ${MODEL_PAYLOAD}
  COMMAND ${ET_PYTHON}
          ${CMAKE_CURRENT_LIST_DIR}/tools/pack_sram0_payload.py
          --output ${MODEL_PAYLOAD} ${MODEL_PAYLOAD_INPUTS}
  DEPENDS ${MODEL_PAYLOAD_INPUTS}
          ${CMAKE_CURRENT_LIST_DIR}/tools/pack_sram0_payload.py
  VERBATIM)
add_custom_target(gen_sram0_payload ALL DEPENDS ${MODEL_PAYLOAD})
add_dependencies(app gen_sram0_payload)

target_sources(app PRIVATE
  src/main.cpp
  src/board_init.c
  src/zephyr_vision.c
  src/ethosu_platform.c
  ${EXECUTORCH_ROOT}/examples/arm/executor_runner/arm_memory_allocator.cpp)
target_include_directories(app PRIVATE
  src ${CMAKE_CURRENT_BINARY_DIR}
  ${EXECUTORCH_ROOT}/examples/arm/executor_runner)

target_link_libraries(app PRIVATE libexecutorch)
# Both programs are completely delegated to Ethos-U.  Do not link the
# Cortex-M fallback kernel catalogue: doing so retains every registered
# quantized CPU kernel even though neither PTE can dispatch one.
if(TARGET executorch_delegate_ethos_u)
  target_link_libraries(app PRIVATE executorch_delegate_ethos_u)
endif()
if(TARGET ethosu_core_driver)
  target_link_libraries(app PRIVATE ethosu_core_driver)
  target_compile_definitions(ethosu_core_driver PRIVATE
    ETHOSU_SEMAPHORE_WAIT_INFERENCE=10000
    # Alif MLEK's E8/U85 settings: use Normal, non-cacheable,
    # non-bufferable transactions.  The core driver's default
    # Device attributes stall when U85 fetches this large model from MRAM.
    NPU_MEM_ATTR_0=0x20
    NPU_MEM_ATTR_1=0x20
    NPU_MEM_ATTR_2=0x24
    NPU_MEM_ATTR_3=0x24
    AXI_LIMIT_SRAM_MAX_BEATS=2
    AXI_LIMIT_EXT_MAX_BEATS=2
    # ensemble_vela.ini advertises the E8 MRAM channel as one outstanding
    # read and no writes.  The driver's generic 64/32 defaults can deadlock
    # the MRAM bridge as soon as the command stream requests constants.
    AXI_LIMIT_EXT_MAX_OUTSTANDING_READ=1
    AXI_LIMIT_EXT_MAX_OUTSTANDING_WRITE=1)
endif()

# The Alif callback implements the legacy single-device ABI. This application
# supplies platform hooks for the multi-variant core driver instead.
set(alif_ethosu_target "..__modules__hal__alif__drivers__ethos_u")
if(TARGET "${alif_ethosu_target}")
  get_target_property(alif_sources "${alif_ethosu_target}" SOURCES)
  list(FILTER alif_sources EXCLUDE REGEX "/ethosu_callback\\.c$")
  if(NOT alif_sources)
    set(alif_sources "${CMAKE_CURRENT_LIST_DIR}/src/ethosu_alif_abi_stub.c")
  endif()
  set_property(TARGET "${alif_ethosu_target}" PROPERTY SOURCES "${alif_sources}")
endif()
```

## Kconfig
```
source "Kconfig.zephyr"

menu "Dual-NPU application"

config DUAL_ET_LIVE_VISION
	bool "Use J16 MT9M114 camera and MW405-C display"
	default n
	help
	  Replace the preloaded BMP with a zero-copy RGB565 camera/display
	  framebuffer. The J16 selfie camera uses RX D-PHY 0 while the display
	  uses TX D-PHY 1.

endmenu
```

## sample.yaml
```
sample:
  name: ExecuTorch dual-NPU live vision
  description: Parallel U55 face detection and U85 person classification
common:
  tags:
    - samples
    - executorch
    - video
  platform_allow:
    - alif_e8_dk/ae822fa0e5597xx0/rtss_hp
  build_only: true
tests:
  sample.modules.executorch.dual_npu_vision: {}
```

## prj.conf
```kconfig
CONFIG_EXECUTORCH=y
CONFIG_FLASH_LOAD_OFFSET=0x400000
CONFIG_EXECUTORCH_BUILD_PORTABLE_OPS=n
CONFIG_CPP=y
CONFIG_STD_CPP17=y
CONFIG_MAIN_STACK_SIZE=16384
CONFIG_HEAP_MEM_POOL_SIZE=65536
CONFIG_SYS_HEAP_AUTO=y
CONFIG_CONSOLE=y
CONFIG_UART_CONSOLE=y
CONFIG_STDOUT_CONSOLE=y
CONFIG_PRINTK=y
CONFIG_SERIAL=y
CONFIG_VIDEO=y
CONFIG_I2C=y
CONFIG_I2C_TARGET=y
CONFIG_I2C_DW_CLOCK_SPEED=100
CONFIG_ARM_ETHOS_U=y
CONFIG_ARM_ETHOS_U_LOG_LEVEL_ERR=y
CONFIG_ASSERT=n
CONFIG_FAULT_DUMP=2
CONFIG_FPU=y
CONFIG_FP_HARDABI=y
CONFIG_TIMESLICING=y
CONFIG_TIMESLICE_SIZE=1
CONFIG_TIMESLICE_PRIORITY=5
```

## vision.conf
```kconfig
CONFIG_DUAL_ET_LIVE_VISION=y
CONFIG_VIDEO=y
CONFIG_VIDEO_MIPI_CSI2_DW=y
CONFIG_VIDEO_ALIF_CAM_EXTENDED=y
CONFIG_MT9M114_PARALLEL_INIT=n
CONFIG_USE_ALIF_ISP_LIB=y
CONFIG_ISP_LIB_SCALAR_MODULE=y
CONFIG_ISP_LIB_DMSC_MODULE=y
CONFIG_ISP_LIB_CCM_MODULE=n
CONFIG_ISP_LIB_WBM_MODULE=n
CONFIG_ISP_LIB_WB_MODULE=n
CONFIG_VIDEO_BUFFER_POOL_SZ_MAX=114688
CONFIG_VIDEO_BUFFER_POOL_NUM_MAX=5
CONFIG_VIDEO_BUFFER_POOL_SRAM1=y
CONFIG_CDC200_FB_USES_SRAM1=y
CONFIG_INIT_STACKS=y
CONFIG_I2C=y
CONFIG_I2C_TARGET=y
CONFIG_I2C_DW_CLOCK_SPEED=100
CONFIG_REGULATOR=y
CONFIG_REGULATOR_FIXED_INIT_PRIORITY=40
CONFIG_MIPI_DSI=y
CONFIG_DISPLAY=y
CONFIG_GPIO_HOGS=y
CONFIG_LOG=y
CONFIG_LOG_DEFAULT_LEVEL=3
```

## isp_route.overlay
```dts
/* Route CPI exclusively into the ISP.  The generic serial_camera overlay
 * also declares the AXI memory endpoint (port 1); video_alif treats the mere
 * presence of that node as AXI enabled and then requires an extra CPI buffer.
 */
&cam {
	ports {
		/delete-node/ port@1;
	};
};
```

## boards/dual_npu_e8.overlay
```dts
/*
 * Alif E8 dual-NPU resources for the RTSS-HP live vision demo.
 * The application supplies the experimental multidevice driver instances.
 */

&ethosu0 {
	compatible = "ethos-multinpu,probe";
	status = "okay";
};

&ethosu1 {
	compatible = "ethos-multinpu,probe";
	status = "okay";
};

&sram1 {
	status = "okay";
};
```

## src/board_init.c
```c
/* SPDX-License-Identifier: Apache-2.0 */

#include <zephyr/device.h>
#include <zephyr/drivers/gpio.h>
#include <zephyr/init.h>
#include <zephyr/sys/__assert.h>
#include <zephyr/sys/sys_io.h>

#include <se_service.h>
#include <soc_common.h>

/*
 * Native E8 camera/display setup from Alif PR #879.  This must run directly
 * after the SE service (priority 45) and before the camera/DSI devices.
 * Keep both NPU clocks enabled for this dual-NPU variant.
 */
static int dual_native_set_parameters(void)
{
	run_profile_t runp = {0};
	int rc;

#if DT_NODE_HAS_STATUS(DT_NODELABEL(camera_select), okay)
	const struct gpio_dt_spec sel =
		GPIO_DT_SPEC_GET(DT_NODELABEL(camera_select), select_gpios);
	(void)gpio_pin_configure_dt(&sel, GPIO_OUTPUT);
	(void)gpio_pin_set_dt(&sel, 1);
#endif

#if defined(CONFIG_ENSEMBLE_GEN2) && defined(CONFIG_MIPI_DSI)
	const struct gpio_dt_spec mux =
		GPIO_DT_SPEC_GET(DT_NODELABEL(mipi_dsi), cam_disp_mux_gpios);
	(void)gpio_pin_configure_dt(&mux, GPIO_OUTPUT_ACTIVE);
#endif

	runp.power_domains = PD_SYST_MASK | PD_SSE700_AON_MASK | PD_DBSS_MASK;
	runp.dcdc_voltage = 825;
	runp.dcdc_mode = DCDC_MODE_PWM;
	runp.aon_clk_src = CLK_SRC_LFXO;
	runp.run_clk_src = CLK_SRC_PLL;
	runp.vdd_ioflex_3V3 = IOFLEX_LEVEL_1V8;
	runp.cpu_clk_freq = CLOCK_FREQUENCY_400MHZ;
	runp.memory_blocks = MRAM_MASK;
#if DT_NODE_EXISTS(DT_NODELABEL(sram0))
	runp.memory_blocks |= SRAM0_MASK;
#endif
#if DT_NODE_EXISTS(DT_NODELABEL(sram1))
	runp.memory_blocks |= SRAM1_MASK;
#endif
	runp.phy_pwr_gating = MIPI_TX_DPHY_MASK | MIPI_RX_DPHY_MASK |
		MIPI_PLL_DPHY_MASK | LDO_PHY_MASK;
	runp.ip_clock_gating = CDC200_MASK | CAMERA_MASK | MIPI_CSI_MASK |
		MIPI_DSI_MASK | NPU_HP_MASK | NPU_HE_MASK;

	rc = se_service_set_run_cfg(&runp);
	__ASSERT(rc == 0, "SE: set_run_cfg failed = %d", rc);
	if (rc != 0) {
		return rc;
	}

	sys_write32(0x140001, CLKCTRL_PER_MST_CAMERA_PIXCLK_CTRL);
	return 0;
}

SYS_INIT(dual_native_set_parameters, PRE_KERNEL_1, 46);
```

## src/ethosu_alif_abi_stub.c
```c
/* SPDX-License-Identifier: Apache-2.0 */

/*
 * Keeps Zephyr's Alif Ethos-U platform library target non-empty after its
 * legacy core-driver callback is replaced by src/ethosu_platform.c.
 */
```

## src/ethosu_platform.c
```c
/* SPDX-License-Identifier: Apache-2.0 */

#include <stdlib.h>
#include <string.h>

#include <cmsis_core.h>
#include <ethosu_device.h>
#include <ethosu_driver.h>
#include <pmu_ethosu.h>
#include <soc_memory_map.h>
#include <zephyr/devicetree.h>
#include <zephyr/cache.h>
#include <zephyr/irq.h>
#include <zephyr/kernel.h>

#define U55_NODE DT_NODELABEL(ethosu0)
#define U85_NODE DT_NODELABEL(ethosu1)

#define ETHOSU_COP1_FOURCC ('1' << 24 | 'P' << 16 | 'O' << 8 | 'C')
#define ETHOSU_COP_OPTIMIZER_CONFIG 1U
#define ETHOSU_COP_COMMAND_STREAM 2U
#define ETHOSU_COP_NOP 5U

static struct ethosu_driver u55_driver;
static struct ethosu_driver u85_driver;
static volatile unsigned u55_irqs;
static volatile unsigned u85_irqs;
static volatile uint64_t u55_submit_cycle;
static volatile uint64_t u85_submit_cycle;
static volatile uint64_t u55_irq_cycle;
static volatile uint64_t u85_irq_cycle;
static volatile uint64_t u55_pmu_cycles;
static volatile uint64_t u85_pmu_cycles;

#define U85_CMD_MIRROR_SIZE (32 * 1024)
#define U85_WEIGHT_MIRROR_SIZE (512 * 1024)
static uint8_t u85_cmd_mirror[U85_CMD_MIRROR_SIZE]
	__attribute__((section(".alif_sram1.u85_mirror"), aligned(32)));
static uint8_t u85_weight_mirror[U85_WEIGHT_MIRROR_SIZE]
	__attribute__((section(".alif_sram1.u85_mirror"), aligned(32)));
static const void *u85_staged_cmd_source;
static const void *u85_staged_weight_source;
static size_t u85_staged_cmd_size;
static size_t u85_staged_weight_size;
static uint8_t u55_fast_scratch[1536] __aligned(16);
static uint8_t u85_fast_scratch[1536] __aligned(16);

/* ExecuTorch's default Ethos-U I/O copy is a plain memcpy. The M55 cache is
 * not coherent with either NPU: invalidate NPU-written sources before CPU
 * reads, and clean CPU-written destinations before NPU reads. This function
 * serves both the input-to-scratch and scratch-to-output copy directions. */
void arm_ethos_io_memcpy(void *dst, const void *src, size_t size)
{
	sys_cache_data_invd_range((void *)src, size);
	memcpy(dst, src, size);
	sys_cache_data_flush_range(dst, size);
}

extern void dual_report_checkpoint(unsigned value);

unsigned char *arm_ethos_fast_scratch_for_product(uint32_t product)
{
	return product == ETHOSU_PRODUCT_U85 ? u85_fast_scratch : u55_fast_scratch;
}

int arm_ethos_prepare_invoke_buffers(uint32_t product,
				     const void **cmd_data,
				     size_t cmd_size,
				     const void **weight_data,
				     size_t weight_size)
{
	if (product != ETHOSU_PRODUCT_U85) {
		return 0;
	}
	/* Shared SRAM0/SRAM1 and MRAM/OSPI are directly visible to U85.
	 * Mirroring is only required for command and weight data linked into
	 * the M55's private ITCM.
	 */
	uintptr_t cmd = (uintptr_t)*cmd_data;
	uintptr_t weights = (uintptr_t)*weight_data;
	bool cmd_visible = (cmd >= DTCM_BASE && cmd < DTCM_BASE + DTCM_SIZE) ||
			   (cmd >= 0x02000000U && cmd < 0x02800000U) ||
			   (cmd >= 0x80000000U && cmd < 0x80600000U);
	bool weights_visible =
		(weights >= DTCM_BASE && weights < DTCM_BASE + DTCM_SIZE) ||
		(weights >= 0x02000000U && weights < 0x02800000U) ||
		(weights >= 0x80000000U && weights < 0x80600000U);
	static unsigned invoke_count;
	if (invoke_count++ == 0U || (invoke_count % 30U) == 0U) {
		printk("dual-et: U85 invoke buffers cmd=%p/%zu weights=%p/%zu visible=%d/%d\n",
		       *cmd_data, cmd_size, *weight_data, weight_size,
		       cmd_visible, weights_visible);
	}
	if (cmd_visible && weights_visible) {
		return 0;
	}
	if (cmd_size > sizeof(u85_cmd_mirror) ||
	    weight_size > sizeof(u85_weight_mirror)) {
		printk("dual-et: U85 invoke buffer overflow cmd=%zu/%zu weights=%zu/%zu\n",
		       cmd_size, sizeof(u85_cmd_mirror), weight_size,
		       sizeof(u85_weight_mirror));
		return -1;
	}

	if (*cmd_data != u85_staged_cmd_source ||
	    *weight_data != u85_staged_weight_source ||
	    cmd_size != u85_staged_cmd_size ||
	    weight_size != u85_staged_weight_size) {
		memcpy(u85_cmd_mirror, *cmd_data, cmd_size);
		memcpy(u85_weight_mirror, *weight_data, weight_size);
		sys_cache_data_flush_range(u85_cmd_mirror, cmd_size);
		sys_cache_data_flush_range(u85_weight_mirror, weight_size);
		u85_staged_cmd_source = *cmd_data;
		u85_staged_weight_source = *weight_data;
		u85_staged_cmd_size = cmd_size;
		u85_staged_weight_size = weight_size;
		printk("dual-et: U85 command/weights staged once cmd=%zu weights=%zu\n",
		       cmd_size, weight_size);
	}
	*cmd_data = u85_cmd_mirror;
	*weight_data = u85_weight_mirror;
	return 0;
}

void *ethosu_mutex_create(void)
{
	struct k_mutex *m = malloc(sizeof(*m));
	if (m != NULL) {
		k_mutex_init(m);
	}
	return m;
}

void ethosu_mutex_destroy(void *mutex) { free(mutex); }
int ethosu_mutex_lock(void *mutex) { return k_mutex_lock(mutex, K_FOREVER); }
int ethosu_mutex_unlock(void *mutex) { return k_mutex_unlock(mutex); }

void *ethosu_semaphore_create(void)
{
	struct k_sem *s = malloc(sizeof(*s));
	if (s != NULL) {
		/* Core-driver main owns the semaphore policy: waiters start empty and
		 * may accumulate one token per registered NPU of the same variant.
		 */
		k_sem_init(s, 0, K_SEM_MAX_LIMIT);
	}
	return s;
}

void ethosu_semaphore_destroy(void *sem) { free(sem); }

int ethosu_semaphore_take(void *sem, uint64_t timeout)
{
	k_timeout_t t = timeout == ETHOSU_SEMAPHORE_WAIT_FOREVER ? K_FOREVER : K_TICKS(timeout);
	return k_sem_take(sem, t);
}

int ethosu_semaphore_give(void *sem)
{
	k_sem_give(sem);
	return 0;
}

static uint64_t alif_address_remap(uint64_t address, int index)
{
	ARG_UNUSED(index);
	return local_to_global((void *)(uintptr_t)address);
}

static unsigned int alif_u85_config_select(uint64_t address, int index)
{
	/* HP DTCM is exposed to the NPUs at its 0x50800000 global alias and
	 * shared SRAM0/SRAM1 occupy 0x02000000-0x027fffff. All must be reached
	 * through U85's SRAM AXI interface (MEM_ATTR 0).
	 */
	if ((address >= DTCM_GLOBAL_BASE &&
	     address < DTCM_GLOBAL_BASE + DTCM_SIZE) ||
	    (address >= 0x02000000ULL && address < 0x02800000ULL)) {
		return 0;
	}
	if (address >= 0x80000000ULL) {
		/* MRAM/OSPI is reached through U85's EXT AXI interface. */
		return 2;
	}

	/* Preserve the U85 backend defaults for non-DTCM regions. */
	if (index < 0) {
		return 2;
	}
	return index == 0 ? 3 : 1;
}

static struct ethosu_device_user_ops alif_u55_user_ops = {
	.address_remap = alif_address_remap,
	.config_select = NULL,
};

static struct ethosu_device_user_ops alif_u85_user_ops = {
	.address_remap = alif_address_remap,
	.config_select = alif_u85_config_select,
};

void ethosu_flush_dcache(const uint64_t *base, const size_t *sizes, int count)
{
	for (int i = 0; i < count; ++i) {
		SCB_CleanDCache_by_Addr((uint32_t *)(uintptr_t)base[i], sizes[i]);
	}
}

void ethosu_invalidate_dcache(const uint64_t *base, const size_t *sizes, int count)
{
	for (int i = 0; i < count; ++i) {
		SCB_InvalidateDCache_by_Addr((uint32_t *)(uintptr_t)base[i], sizes[i]);
	}
}

static void u55_isr(const void *unused)
{
	ARG_UNUSED(unused);
	u55_irq_cycle = k_cycle_get_64();
	u55_irqs++;
	ethosu_irq_handler(&u55_driver);
}

static void u85_isr(const void *unused)
{
	ARG_UNUSED(unused);
	u85_irq_cycle = k_cycle_get_64();
	u85_irqs++;
	ethosu_irq_handler(&u85_driver);
}

void ethosu_inference_begin(struct ethosu_driver *drv, void *user_arg)
{
	ARG_UNUSED(user_arg);
	if (drv == &u55_driver) {
		u55_submit_cycle = k_cycle_get_64();
	} else if (drv == &u85_driver) {
		u85_submit_cycle = k_cycle_get_64();
	}

	/* Count only cycles for which the NPU reports ACTIVE. This excludes the
	 * ExecuTorch method dispatch, tensor copies and CPU quantization work from
	 * the accelerator metric while the existing k_cycle timing retains the
	 * complete method->execute() latency. */
	ETHOSU_PMU_Enable(drv);
	ETHOSU_PMU_PMCCNTR_CFG_Set_Start_Event(drv, ETHOSU_PMU_NPU_ACTIVE);
	ETHOSU_PMU_PMCCNTR_CFG_Set_Stop_Event(drv, ETHOSU_PMU_NPU_IDLE);
	ETHOSU_PMU_CNTR_Enable(drv, ETHOSU_PMU_CCNT_Msk);
	ETHOSU_PMU_CYCCNT_Reset(drv);
}

void ethosu_inference_end(struct ethosu_driver *drv, void *user_arg)
{
	ARG_UNUSED(user_arg);
	uint64_t cycles = ETHOSU_PMU_Get_CCNTR(drv);
	ETHOSU_PMU_CNTR_Disable(drv, ETHOSU_PMU_CCNT_Msk);
	ETHOSU_PMU_Disable(drv);
	if (drv == &u55_driver) {
		u55_pmu_cycles = cycles;
	} else if (drv == &u85_driver) {
		u85_pmu_cycles = cycles;
	}
}

int dual_ethosu_init(void)
{
	int ret;

	dual_report_checkpoint(0x201);
	ret = ethosu_init_ex(&u55_driver, &ethosu_device_desc_u55,
			     &ethosu_device_config_u55, &alif_u55_user_ops,
			     (void *)DT_REG_ADDR(U55_NODE), NULL, 0, 1, 1);
	if (ret != 0) {
		return ret;
	}

	dual_report_checkpoint(0x202);
	ret = ethosu_init_ex(&u85_driver, &ethosu_device_desc_u85,
			     &ethosu_device_config_u85, &alif_u85_user_ops,
			     (void *)DT_REG_ADDR(U85_NODE), NULL, 0, 1, 1);
	if (ret != 0) {
		return ret;
	}

	dual_report_checkpoint(0x203);
	IRQ_CONNECT(DT_IRQN(U55_NODE), 3, u55_isr, NULL, 0);
	IRQ_CONNECT(DT_IRQN(U85_NODE), 3, u85_isr, NULL, 0);
	dual_report_checkpoint(0x204);
	irq_enable(DT_IRQN(U55_NODE));
	dual_report_checkpoint(0x205);
	irq_enable(DT_IRQN(U85_NODE));
	dual_report_checkpoint(0x206);
	return 0;
}

unsigned dual_ethosu_u55_irqs(void) { return u55_irqs; }
unsigned dual_ethosu_u85_irqs(void) { return u85_irqs; }
uint64_t dual_ethosu_u55_submit_cycle(void) { return u55_submit_cycle; }
uint64_t dual_ethosu_u85_submit_cycle(void) { return u85_submit_cycle; }
uint64_t dual_ethosu_u55_irq_cycle(void) { return u55_irq_cycle; }
uint64_t dual_ethosu_u85_irq_cycle(void) { return u85_irq_cycle; }
uint64_t dual_ethosu_u55_pmu_cycles(void) { return u55_pmu_cycles; }
uint64_t dual_ethosu_u85_pmu_cycles(void) { return u85_pmu_cycles; }
```

## src/zephyr_vision.c
```c
/* SPDX-License-Identifier: Apache-2.0 */

#include <errno.h>
#include <stdint.h>
#include <stdio.h>
#include <string.h>
#include <zephyr/cache.h>
#include <zephyr/device.h>
#include <zephyr/drivers/display.h>
#include <zephyr/drivers/display/cdc200.h>
#include <zephyr/drivers/mipi_dsi/dsi_dw.h>
#include <zephyr/drivers/video.h>
#include <zephyr/drivers/video/video_alif.h>
#include <zephyr/kernel.h>
#include <zephyr/sys/printk.h>

#define DISPLAY_WIDTH 480U
#define DISPLAY_HEIGHT 800U
#define PREVIEW_HEIGHT 352U
#define PREVIEW_Y (((DISPLAY_HEIGHT - PREVIEW_HEIGHT) / 2U) - 40U)
#define CAMERA_OUTPUT_WIDTH 192U
#define CAMERA_OUTPUT_HEIGHT 192U
#define PREVIEW_X ((DISPLAY_WIDTH - PREVIEW_HEIGHT) / 2U)
static const struct device *display_dev;
static const struct device *camera_dev;
static uint16_t *framebuffer;
static struct video_buffer *camera_buffer;
static struct video_buffer *camera_buffers[5];
static struct video_format camera_format;
static bool camera_started;
static bool camera_streaming;

/* Callback required by Alif's ISP wrapper. Keep the vendor library quiet;
 * Zephyr-side failures are still reported by the video driver. */
int log_level(void) { return 0; }

static int start_camera(void)
{
	struct video_caps caps;
	int rc;

	if (camera_started) return 0;
	/* Match the updated Alif reference pipeline: RAW10 from MT9M114 is
	 * demosaiced by the hardware ISP into planar RGB888. */
	camera_dev = DEVICE_DT_GET_ONE(vsi_isp_pico);
	if (!device_is_ready(camera_dev)) return -ENODEV;

	memset(&caps, 0, sizeof(caps));
	rc = video_get_caps(camera_dev, VIDEO_EP_IN, &caps);
	if (rc != 0) return rc;
	for (const struct video_format_cap *cap = caps.format_caps;
	     cap != NULL && cap->pixelformat != 0; ++cap) {
		if (cap->pixelformat == VIDEO_PIX_FMT_Y10P) {
			/* Match the PR reference: keep walking so the last Y10P
			 * capability (1288x728 for MT9M114) is selected.  The
			 * sensor-specific crop-x0=280 is invalid for 640x480. */
			camera_format.pixelformat = VIDEO_PIX_FMT_Y10P;
			camera_format.width = cap->width_min;
			camera_format.height = cap->height_min;
			camera_format.pitch = cap->width_min * 2U;
		}
	}
	if (camera_format.pixelformat == 0) return -ENOTSUP;
	printk("dual-et: ISP input selected %ux%u pitch=%u\n",
	       camera_format.width, camera_format.height, camera_format.pitch);
	rc = video_set_format(camera_dev, VIDEO_EP_IN, &camera_format);
	if (rc != 0) return rc;
	camera_format.pixelformat = VIDEO_PIX_FMT_RGB888_PLANAR_PRIVATE;
	/* The MT9M114-specific ISP overlay selects a centered 728x728 ROI.
	 * Keep the ISP output square as well; requesting 480x272 from that ROI is
	 * rejected by the updated ISP library and previously exposed invalid edge
	 * pixels as noise. */
	camera_format.width = CAMERA_OUTPUT_WIDTH;
	camera_format.height = CAMERA_OUTPUT_HEIGHT;
	camera_format.pitch = camera_format.width * 3U;
	rc = video_set_format(camera_dev, VIDEO_EP_OUT, &camera_format);
	if (rc != 0) return rc;
	const size_t capture_size = (size_t)camera_format.pitch * camera_format.height;

	for (size_t i = 0; i < ARRAY_SIZE(camera_buffers); ++i) {
		camera_buffers[i] = video_buffer_alloc(capture_size, K_NO_WAIT);
		if (camera_buffers[i] == NULL) {
			printk("dual-et: camera buffer %zu allocation failed size=%zu\n",
			       i, capture_size);
			return -ENOMEM;
		}
		rc = video_enqueue(camera_dev, VIDEO_EP_OUT, camera_buffers[i]);
		if (rc != 0) {
			printk("dual-et: camera buffer %zu enqueue failed rc=%d\n", i, rc);
			return rc;
		}
	}
	camera_started = true;
	printk("dual-et: Zephyr MT9M114 ready %ux%u pitch=%u buffers=%zu first=%p/%u\n",
	       camera_format.width, camera_format.height, camera_format.pitch,
	       ARRAY_SIZE(camera_buffers), camera_buffers[0]->buffer,
	       (unsigned)camera_buffers[0]->size);
	return 0;
}

int zephyr_dual_display_init(void)
{
	const struct device *panel = DEVICE_DT_GET(DT_ALIAS(panel));
	const struct device *dsi = DEVICE_DT_GET(DT_ALIAS(mipi_dsi));
	struct cdc200_fb_desc fb = {0};
	int rc;

	display_dev = DEVICE_DT_GET(DT_CHOSEN(zephyr_display));
	if (!device_is_ready(panel) || !device_is_ready(dsi) ||
	    !device_is_ready(display_dev)) return -ENODEV;
	rc = dsi_dw_set_mode(dsi, DSI_DW_VIDEO_MODE);
	if (rc == 0) rc = display_blanking_off(panel);
	if (rc != 0) return rc;
	cdc200_set_enable(display_dev, true);
	cdc200_get_framebuffer(display_dev, 0, &fb);
	if (fb.fb_addr == NULL || fb.fb_size < DISPLAY_WIDTH * DISPLAY_HEIGHT * 2U)
		return -ENOMEM;
	framebuffer = (uint16_t *)fb.fb_addr;
	memset(framebuffer, 0, DISPLAY_WIDTH * DISPLAY_HEIGHT * 2U);
	sys_cache_data_flush_range(framebuffer, DISPLAY_WIDTH * DISPLAY_HEIGHT * 2U);
	printk("dual-et: Zephyr MW405 ready fb=%p/%zu\n", fb.fb_addr, fb.fb_size);
	rc = start_camera();
	if (rc != 0) printk("dual-et: camera initialization failed rc=%d\n", rc);
	return rc;
}

uint16_t *zephyr_dual_preview_buffer(void)
{
	return framebuffer ? framebuffer + PREVIEW_Y * DISPLAY_WIDTH : NULL;
}

int zephyr_dual_capture_preview(void)
{
	struct video_buffer *captured = NULL;
	int rc = start_camera();
	if (rc != 0) return rc;

	/* Return the frame held stable during the previous inference, while four
	 * other buffers kept the continuously streaming CSI/CPI pipeline fed. */
	if (camera_buffer != NULL) {
		rc = video_enqueue(camera_dev, VIDEO_EP_OUT, camera_buffer);
		if (rc != 0) return rc;
		camera_buffer = NULL;
	}
	if (!camera_streaming) {
		rc = video_stream_start(camera_dev);
		if (rc != 0 && rc != -EBUSY) return rc;
		camera_streaming = true;
	}
	/* The Alif CPI driver can transiently return EAGAIN at a frame boundary
	 * even with a blocking timeout. Preserve the queued-buffer state and wait
	 * briefly for the next completed buffer instead of dropping the frame. */
	for (unsigned retry = 0; retry < 50U; ++retry) {
		rc = video_dequeue(camera_dev, VIDEO_EP_OUT, &captured, K_MSEC(100));
		if (rc != -EAGAIN) break;
	}
	if (rc != 0 || captured == NULL) return rc != 0 ? rc : -EIO;
	/* Inference is slower than the camera. Drain all already-completed frames,
	 * requeue stale ones, and retain only the newest frame. Without this step
	 * one completed buffer accumulates per iteration until the pool empties. */
	for (;;) {
		struct video_buffer *newer = NULL;
		rc = video_dequeue(camera_dev, VIDEO_EP_OUT, &newer, K_NO_WAIT);
		if (rc == -EAGAIN) break;
		if (rc != 0 || newer == NULL) return rc != 0 ? rc : -EIO;
		rc = video_enqueue(camera_dev, VIDEO_EP_OUT, captured);
		if (rc != 0) return rc;
		captured = newer;
	}
	camera_buffer = captured;
	sys_cache_data_invd_range(camera_buffer->buffer,
		(size_t)camera_format.pitch * camera_format.height);

	const size_t plane_size = (size_t)camera_format.width * camera_format.height;
	const uint8_t *red = camera_buffer->buffer;
	const uint8_t *green = red + plane_size;
	const uint8_t *blue = green + plane_size;
	for (uint32_t y = 0; y < PREVIEW_HEIGHT; ++y) {
		const uint32_t sy = y * camera_format.height / PREVIEW_HEIGHT;
		uint16_t *dst = framebuffer + (PREVIEW_Y + y) * DISPLAY_WIDTH;
		memset(dst, 0, DISPLAY_WIDTH * sizeof(*dst));
		for (uint32_t x = 0; x < PREVIEW_HEIGHT; ++x) {
			const uint32_t sx = x * camera_format.width / PREVIEW_HEIGHT;
			const size_t i = (size_t)sy * camera_format.width + sx;
			dst[PREVIEW_X + x] = ((uint16_t)(red[i] >> 3) << 11) |
				 ((uint16_t)(green[i] >> 2) << 5) | (blue[i] >> 3);
		}
	}
	sys_cache_data_flush_range(framebuffer + PREVIEW_Y * DISPLAY_WIDTH,
		PREVIEW_HEIGHT * DISPLAY_WIDTH * 2U);
	return 0;
}

int zephyr_dual_release_frame(void)
{
	if (camera_buffer == NULL) return 0;
	int rc = video_enqueue(camera_dev, VIDEO_EP_OUT, camera_buffer);
	if (rc == 0) camera_buffer = NULL;
	return rc;
}

void zephyr_dual_get_rgb(uint32_t x, uint32_t y,
			 uint8_t *red, uint8_t *green, uint8_t *blue)
{
	/* x is expressed in the logical 480x272 preview coordinate system used by
	 * both models. Scale it onto the centered square camera image. */
	const uint32_t sx = x * camera_format.width / DISPLAY_WIDTH;
	const uint32_t sy = y * camera_format.height / PREVIEW_HEIGHT;
	const size_t plane_size = (size_t)camera_format.width * camera_format.height;
	const size_t i = (size_t)sy * camera_format.width + sx;
	const uint8_t *planes = camera_buffer->buffer;
	*red = planes[i];
	*green = planes[plane_size + i];
	*blue = planes[2U * plane_size + i];
}

static void reload_display(void)
{
	sys_cache_data_flush_range(framebuffer, DISPLAY_WIDTH * DISPLAY_HEIGHT * 2U);
}

static void summary_text(uint32_t x, uint32_t y, const char *text, uint16_t color);
void zephyr_dual_clear_display(void)
{
	memset(framebuffer, 0, DISPLAY_WIDTH * DISPLAY_HEIGHT * 2U);
	reload_display();
}

static const uint8_t *summary_glyph(char c)
{
	static const uint8_t digits[10][7] = {
		{14,17,19,21,25,17,14},{4,12,4,4,4,4,14},{14,17,1,2,4,8,31},
		{30,1,1,14,1,1,30},{2,6,10,18,31,2,2},{31,16,16,30,1,1,30},
		{14,16,16,30,17,17,14},{31,1,2,4,8,8,8},{14,17,17,14,17,17,14},
		{14,17,17,15,1,1,14}};
	static const uint8_t letters[26][7] = {
		{14,17,17,31,17,17,17},{30,17,17,30,17,17,30},{14,17,16,16,16,17,14},
		{30,17,17,17,17,17,30},{31,16,16,30,16,16,31},{31,16,16,30,16,16,16},
		{14,17,16,23,17,17,15},{17,17,17,31,17,17,17},{14,4,4,4,4,4,14},
		{1,1,1,1,17,17,14},{17,18,20,24,20,18,17},{16,16,16,16,16,16,31},
		{17,27,21,21,17,17,17},{17,25,25,21,19,19,17},{14,17,17,17,17,17,14},
		{30,17,17,30,16,16,16},{14,17,17,17,21,18,13},{30,17,17,30,20,18,17},
		{15,16,16,14,1,1,30},{31,4,4,4,4,4,4},{17,17,17,17,17,17,14},
		{17,17,17,17,17,10,4},{17,17,17,21,21,21,10},{17,17,10,4,10,17,17},
		{17,17,10,4,4,4,4},{31,1,2,4,8,16,31}};
	static const uint8_t blank[7]={0};
	if (c >= '0' && c <= '9') return digits[c - '0'];
	if (c >= 'A' && c <= 'Z') return letters[c - 'A'];
	return blank;
}

void zephyr_dual_show_ssd_result(int faces)
{
	char line[24];
	for (uint32_t y = 12U; y < 38U; ++y)
		memset(framebuffer + y * DISPLAY_WIDTH, 0, DISPLAY_WIDTH * sizeof(*framebuffer));
	snprintf(line, sizeof(line), "U55 SSD F %d", faces);
	summary_text(18U, 14U, line, faces > 0 ? 0x07e0 : 0xffff);
	reload_display();
}

void zephyr_dual_show_classification(int class_id, int confidence, const char *label)
{
	char line[28];
	for (uint32_t y = 42U; y < 70U; ++y)
		memset(framebuffer + y * DISPLAY_WIDTH, 0, DISPLAY_WIDTH * sizeof(*framebuffer));
	snprintf(line, sizeof(line), "U85 %s %d", label && label[0] ? label : "CLASS", confidence);
	summary_text(18U, 44U, line, class_id >= 0 ? 0x07ff : 0xffff);
	reload_display();
}

void zephyr_dual_reset_results(void)
{
	zephyr_dual_show_ssd_result(0);
	zephyr_dual_show_classification(-1, 0, "CLASS");
}

static void summary_text(uint32_t x, uint32_t y, const char *text, uint16_t color)
{
	const uint32_t scale = 3U;
	for (; *text; ++text, x += 6U * scale) {
		const uint8_t *glyph = summary_glyph(*text);
		for (uint32_t row = 0; row < 7U; ++row)
			for (uint32_t col = 0; col < 5U; ++col)
				if (glyph[row] & BIT(4U-col))
					for (uint32_t dy=0; dy<scale; ++dy)
						for (uint32_t dx=0; dx<scale; ++dx)
							framebuffer[(y+row*scale+dy)*DISPLAY_WIDTH+x+col*scale+dx]=color;
	}
}

void zephyr_dual_show_parallel_summary(uint32_t samples, uint32_t u55_us,
	uint32_t u85_us, uint32_t span_us, uint32_t overlap_us)
{
	char line[24]; const uint32_t top=575U;
	for (uint32_t y=top; y<735U; ++y)
		for (uint32_t x=16U; x<464U; ++x) framebuffer[y*DISPLAY_WIDTH+x]=0;
	summary_text(24U,top,"PAR AVG US",0xffe0);
	snprintf(line,sizeof(line),"U55 %lu",(unsigned long)u55_us); summary_text(24U,top+28U,line,0xffff);
	snprintf(line,sizeof(line),"U85 %lu",(unsigned long)u85_us); summary_text(24U,top+56U,line,0xffff);
	snprintf(line,sizeof(line),"SPAN %lu",(unsigned long)span_us); summary_text(24U,top+84U,line,0x07ff);
	snprintf(line,sizeof(line),"OVLP %lu",(unsigned long)overlap_us); summary_text(24U,top+112U,line,overlap_us?0x07e0:0xf800);
	snprintf(line,sizeof(line),"N %lu",(unsigned long)samples); summary_text(300U,top,line,0xffff);
	reload_display();
}

void zephyr_dual_show_bmp(const uint8_t *bmp)
{
	const uint8_t *pixels=bmp+54U; const uint32_t size=PREVIEW_HEIGHT;
	const uint32_t xoff=(DISPLAY_WIDTH-size)/2U;
	for (uint32_t y=0; y<PREVIEW_HEIGHT; ++y) {
		memset(framebuffer+(PREVIEW_Y+y)*DISPLAY_WIDTH,0,DISPLAY_WIDTH*2U);
		for (uint32_t x=0; x<size; ++x) {
			uint32_t sx=x*192U/size, sy=191U-y*192U/size;
			const uint8_t *bgr=pixels+(sy*192U+sx)*3U;
			framebuffer[(PREVIEW_Y+y)*DISPLAY_WIDTH+xoff+x]=
				((uint16_t)(bgr[2]>>3)<<11)|((uint16_t)(bgr[1]>>2)<<5)|(bgr[0]>>3);
		}
	}
	reload_display();
}
```
